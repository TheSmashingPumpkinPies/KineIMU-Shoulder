## tests/firmware/node_a_acquisition/testcase.yaml
```yaml
tests:
  kineimu.node_a.acquisition:
    harness: ztest
    platform_allow:
      - qemu_cortex_m3
    tags:
      - sensor
      - unit
```
