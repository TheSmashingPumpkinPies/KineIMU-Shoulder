## CMakeLists.txt
```
# SPDX-License-Identifier: Apache-2.0

cmake_minimum_required(VERSION 3.20.0)

find_package(Zephyr REQUIRED HINTS $ENV{ZEPHYR_BASE})
project(kineimu_node_a_acquisition_tests)

set(NODE_A_SOURCE_DIR
    ${CMAKE_CURRENT_SOURCE_DIR}/../../../firmware/xiao_nrf52840_sense/node_a_bringup/src)

target_include_directories(app PRIVATE ${NODE_A_SOURCE_DIR})
target_sources(app PRIVATE src/test_acquisition.c)
target_sources(app PRIVATE src/test_ble_codec.c)
target_sources(app PRIVATE src/test_ble_advertising_work.c)
target_sources(app PRIVATE src/test_ble_transport_policy.c)
target_sources(app PRIVATE src/test_ble_tx_queue.c)
target_sources(app PRIVATE src/test_ble_tx_completion.c)
target_sources(app PRIVATE src/test_ble_tx_diagnostics.c)
target_sources(app PRIVATE src/test_register_snapshot.c)
target_sources(app PRIVATE src/test_ble_identity.c)
target_sources(app PRIVATE src/test_m1_conn_param_experiment.c)
target_sources(app PRIVATE src/test_m1_conn_param_control.c)

# Exercise the same explicit Node-B build selection used by the physical
# compatibility image. Packet golden vectors use an explicit node ID where
# they are testing the codec rather than the application identity.
target_compile_definitions(app PRIVATE KINEIMU_NODE_ID=2)

# Include production modules when available; acquisition tests retain weak
# fallbacks only for components outside their focused build configuration.
if(EXISTS ${NODE_A_SOURCE_DIR}/acquisition.c)
  target_sources(app PRIVATE ${NODE_A_SOURCE_DIR}/acquisition.c)
endif()

if(EXISTS ${NODE_A_SOURCE_DIR}/acquisition_trace.c)
  target_sources(app PRIVATE ${NODE_A_SOURCE_DIR}/acquisition_trace.c)
endif()

if(EXISTS ${NODE_A_SOURCE_DIR}/timestamp.c)
  target_sources(app PRIVATE ${NODE_A_SOURCE_DIR}/timestamp.c)
endif()

if(EXISTS ${NODE_A_SOURCE_DIR}/counters.c)
  target_sources(app PRIVATE ${NODE_A_SOURCE_DIR}/counters.c)
endif()

if(EXISTS ${NODE_A_SOURCE_DIR}/sample_queue.c)
  target_sources(app PRIVATE ${NODE_A_SOURCE_DIR}/sample_queue.c)
endif()

if(EXISTS ${NODE_A_SOURCE_DIR}/lsm6dsl_raw.c)
  target_sources(app PRIVATE ${NODE_A_SOURCE_DIR}/lsm6dsl_raw.c)
endif()

if(EXISTS ${NODE_A_SOURCE_DIR}/lsm6dsl_fifo.c)
  target_sources(app PRIVATE ${NODE_A_SOURCE_DIR}/lsm6dsl_fifo.c)
endif()

if(EXISTS ${NODE_A_SOURCE_DIR}/packet.c)
  target_sources(app PRIVATE ${NODE_A_SOURCE_DIR}/packet.c)
endif()

if(EXISTS ${NODE_A_SOURCE_DIR}/identity.c)
  target_sources(app PRIVATE ${NODE_A_SOURCE_DIR}/identity.c)
endif()

if(EXISTS ${NODE_A_SOURCE_DIR}/m1_ble_codec.c)
  target_sources(app PRIVATE ${NODE_A_SOURCE_DIR}/m1_ble_codec.c)
endif()

if(EXISTS ${NODE_A_SOURCE_DIR}/m1_ble_advertising.c)
  target_sources(app PRIVATE ${NODE_A_SOURCE_DIR}/m1_ble_advertising.c)
endif()

if(EXISTS ${NODE_A_SOURCE_DIR}/m1_ble_transport_policy.c)
  target_sources(app PRIVATE ${NODE_A_SOURCE_DIR}/m1_ble_transport_policy.c)
endif()

if(EXISTS ${NODE_A_SOURCE_DIR}/m1_ble_tx_queue.c)
  target_sources(app PRIVATE ${NODE_A_SOURCE_DIR}/m1_ble_tx_queue.c)
endif()

if(EXISTS ${NODE_A_SOURCE_DIR}/m1_ble_tx_completion.c)
  target_sources(app PRIVATE ${NODE_A_SOURCE_DIR}/m1_ble_tx_completion.c)
endif()

target_sources(app PRIVATE ${NODE_A_SOURCE_DIR}/m1_ble_tx_diagnostics.c)

if(EXISTS ${NODE_A_SOURCE_DIR}/m1_conn_param_experiment.c)
  target_sources(app PRIVATE ${NODE_A_SOURCE_DIR}/m1_conn_param_experiment.c)
endif()

if(EXISTS ${NODE_A_SOURCE_DIR}/m1_conn_param_control.c)
  target_sources(app PRIVATE ${NODE_A_SOURCE_DIR}/m1_conn_param_control.c)
endif()

if(EXISTS ${NODE_A_SOURCE_DIR}/m1_ble_identity.c)
  target_sources(app PRIVATE ${NODE_A_SOURCE_DIR}/m1_ble_identity.c)
endif()
```

## prj.conf
```kconfig
CONFIG_SENSOR=y
CONFIG_ZTEST=y
CONFIG_GPIO=y
CONFIG_GPIO_EMUL=y
CONFIG_TEST_EXTRA_STACK_SIZE=2048
# Keep per-case START/PASS output but omit its duplicate verbose end summary.
CONFIG_ZTEST_VERBOSE_SUMMARY=n
```

## app.overlay
```dts
/* SPDX-License-Identifier: Apache-2.0 */

#include <zephyr/dt-bindings/gpio/gpio.h>

/ {
	node_a_test_gpio: node-a-test-gpio {
		compatible = "zephyr,gpio-emul";
		gpio-controller;
		#gpio-cells = <2>;
		ngpios = <1>;
		rising-edge;
		status = "okay";
	};
};
```

## src/test_ble_advertising_work.c
```c
/*
 * Copyright (c) 2026 KineIMU Shoulder contributors
 * SPDX-License-Identifier: Apache-2.0
 */

#include <errno.h>

#include <zephyr/kernel.h>
#include <zephyr/sys/util.h>
#include <zephyr/ztest.h>

#include "m1_ble_advertising.h"

struct advertising_probe {
	struct k_sem called;
	uint32_t calls;
	int return_code;
	int return_codes[2];
	size_t return_code_count;
	bool ran_in_isr;
};

static int probe_start(void *context)
{
	struct advertising_probe *probe = context;

	probe->calls++;
	probe->ran_in_isr = k_is_in_isr();
	k_sem_give(&probe->called);
	if (probe->return_code_count > 0U) {
		const size_t index = MIN(probe->calls - 1U, probe->return_code_count - 1U);
		return probe->return_codes[index];
	}
	return probe->return_code;
}

ZTEST(node_a_ble_advertising_work,
	test_restart_request_runs_start_on_system_workqueue)
{
	struct advertising_probe probe = {
		.return_code = 0,
	};
	struct node_a_ble_advertising_restart restart;

	k_sem_init(&probe.called, 0, 1);
	node_a_ble_advertising_restart_init(&restart, probe_start, &probe);
	zassert_true(node_a_ble_advertising_restart_request(&restart) >= 0);
	zassert_ok(k_sem_take(&probe.called, K_MSEC(1000)));
	zassert_equal(probe.calls, 1U);
	zassert_false(probe.ran_in_isr);
}

ZTEST(node_a_ble_advertising_work,
	test_already_advertising_is_an_acceptable_restart_result)
{
	struct advertising_probe probe = {
		.return_code = -EALREADY,
	};
	struct node_a_ble_advertising_restart restart;

	k_sem_init(&probe.called, 0, 1);
	node_a_ble_advertising_restart_init(&restart, probe_start, &probe);
	zassert_true(node_a_ble_advertising_restart_request(&restart) >= 0);
	zassert_ok(k_sem_take(&probe.called, K_MSEC(1000)));
	zassert_equal(probe.calls, 1U);
}

ZTEST(node_a_ble_advertising_work,
	test_transient_start_failure_is_retried_on_system_workqueue)
{
	struct advertising_probe probe = {
		.return_codes = {-ENOMEM, 0},
		.return_code_count = 2U,
	};
	struct node_a_ble_advertising_restart restart;

	k_sem_init(&probe.called, 0, 1);
	node_a_ble_advertising_restart_init(&restart, probe_start, &probe);
	zassert_true(node_a_ble_advertising_restart_request(&restart) >= 0);
	zassert_ok(k_sem_take(&probe.called, K_MSEC(1000)));
	zassert_ok(k_sem_take(&probe.called, K_MSEC(1000)));
	zassert_equal(probe.calls, 2U);
	zassert_false(probe.ran_in_isr);
}

ZTEST_SUITE(node_a_ble_advertising_work, NULL, NULL, NULL, NULL, NULL);
```

## src/test_ble_codec.c
```c
/*
 * Copyright (c) 2026 KineIMU Shoulder contributors
 * SPDX-License-Identifier: Apache-2.0
 */

#include <errno.h>
#include <stddef.h>
#include <stdint.h>
#include <string.h>

#include <zephyr/ztest.h>

#include "m1_ble_codec.h"

static const uint8_t identity_config_golden[] = {
	0x4b, 0x49, 0x01, 0x02, 0x01, 0x01, 0x00, 0x01, 0x00, 0x04,
	0x02, 0x00, 0x00, 0x00, 0x03, 0x00, 0x00, 0x00, 0x08, 0x07,
	0x06, 0x05, 0x04, 0x03, 0x02, 0x01, 0x18, 0x17, 0x16, 0x15,
	0x14, 0x13, 0x12, 0x11, 0x01, 0x02, 0x03, 0x04, 0x05, 0x06,
	0x07, 0x08, 0x09, 0x0a, 0x0b, 0x0c, 0x0d, 0x0e, 0x0f, 0x10,
	0x11, 0x12, 0x13, 0x14, 0x40, 0x42, 0x0f, 0x00, 0x40, 0x96,
	0x01, 0x00, 0x40, 0x96, 0x01, 0x00, 0xa0, 0x0f, 0x00, 0x00,
	0x20, 0xa1, 0x07, 0x00, 0x00, 0x01, 0x02, 0x03, 0x04, 0x05,
	0x06, 0x07, 0x08, 0x09, 0x0a, 0x0b, 0x0c, 0x0d, 0x0e, 0x0f,
	0x10, 0x11, 0x12, 0xce, 0x5c, 0x85, 0xb0,
};

static const uint8_t clock_request_golden[] = {
	0x4b, 0x49, 0x01, 0x03, 0x09, 0x00, 0x00, 0x00, 0x15, 0x81,
	0xe9, 0x7d, 0xf4, 0x10, 0x22, 0x11, 0x1d, 0xd8, 0x8d, 0x59,
};

static const uint8_t clock_response_golden[] = {
	0x4b, 0x49, 0x01, 0x04, 0x09, 0x00, 0x00, 0x00, 0x15, 0x81,
	0xe9, 0x7d, 0xf4, 0x10, 0x22, 0x11, 0x08, 0x07, 0x06, 0x05,
	0x04, 0x03, 0x02, 0x01, 0x03, 0x00, 0x00, 0x00, 0xb1, 0x68,
	0xde, 0x3a, 0x00, 0x00, 0x00, 0x00, 0xce, 0x68, 0xde, 0x3a,
	0x00, 0x00, 0x00, 0x00, 0x9e, 0x96, 0x4e, 0xa6,
};

static const uint8_t status_golden[] = {
	0x4b, 0x49, 0x01, 0x05, 0x01, 0x02, 0x03, 0x00, 0x08, 0x07,
	0x06, 0x05, 0x04, 0x03, 0x02, 0x01, 0x03, 0x00, 0x00, 0x00,
	0x04, 0x00, 0x00, 0x00, 0x64, 0x00, 0x00, 0x00, 0x18, 0x00,
	0x00, 0x00, 0x65, 0x00, 0x00, 0x00, 0x00, 0x00, 0x00, 0x00,
	0x19, 0x00, 0x00, 0x00, 0x00, 0x00, 0x00, 0x00, 0x00, 0x00,
	0x00, 0x00, 0x01, 0x00, 0x00, 0x00, 0x02, 0x00, 0x00, 0x00,
	0x03, 0x00, 0x00, 0x00, 0x04, 0x00, 0x00, 0x00, 0x05, 0x00,
	0x00, 0x00, 0x06, 0x00, 0x00, 0x00, 0xc9, 0x2c, 0x93, 0x0f,
};

ZTEST(node_a_ble_codec, test_encodes_identity_config_golden_vector)
{
	const struct node_a_ble_identity_config config = {
		.node_id = 1U,
		.timestamp_source = 1U,
		.firmware_version = {0U, 1U, 0U},
		.batch_size = 4U,
		.config_generation = 2U,
		.clock_epoch = 3U,
		.boot_id = 0x0102030405060708ULL,
		.hardware_device_id = 0x1112131415161718ULL,
		.firmware_git_commit = {
			0x01, 0x02, 0x03, 0x04, 0x05, 0x06, 0x07, 0x08, 0x09, 0x0a,
			0x0b, 0x0c, 0x0d, 0x0e, 0x0f, 0x10, 0x11, 0x12, 0x13, 0x14,
		},
		.timer_frequency_hz = 1000000U,
		.accel_odr_millihz = 104000U,
		.gyro_odr_millihz = 104000U,
		.accel_range_mg = 4000U,
		.gyro_range_mdps = 500000U,
		.sensor_registers = {
			0x00, 0x01, 0x02, 0x03, 0x04, 0x05, 0x06, 0x07, 0x08, 0x09,
			0x0a, 0x0b, 0x0c, 0x0d, 0x0e, 0x0f, 0x10, 0x11, 0x12,
		},
	};
	uint8_t encoded[NODE_A_BLE_IDENTITY_CONFIG_SIZE];
	size_t encoded_size = 0U;

	zassert_ok(node_a_ble_encode_identity_config(
			&config, encoded, sizeof(encoded), &encoded_size));
	zassert_equal(encoded_size, sizeof(identity_config_golden));
	zassert_mem_equal(encoded, identity_config_golden,
			  sizeof(identity_config_golden));
}

ZTEST(node_a_ble_codec, test_decodes_clock_request_golden_vector)
{
	struct node_a_ble_clock_request request = {0};

	zassert_ok(node_a_ble_decode_clock_request(
			clock_request_golden, sizeof(clock_request_golden), &request));
	zassert_equal(request.transaction_id, 9U);
	zassert_equal(request.host_send_ns, 1234567890123456789ULL);
}

ZTEST(node_a_ble_codec, test_encodes_clock_response_golden_vector)
{
	const struct node_a_ble_clock_response response = {
		.transaction_id = 9U,
		.host_send_ns = 1234567890123456789ULL,
		.boot_id = 0x0102030405060708ULL,
		.clock_epoch = 3U,
		.device_receive_us = 987654321ULL,
		.device_indication_queued_us = 987654350ULL,
	};
	uint8_t encoded[NODE_A_BLE_CLOCK_RESPONSE_SIZE];
	size_t encoded_size = 0U;

	zassert_ok(node_a_ble_encode_clock_response(
			&response, encoded, sizeof(encoded), &encoded_size));
	zassert_equal(encoded_size, sizeof(clock_response_golden));
	zassert_mem_equal(encoded, clock_response_golden,
			  sizeof(clock_response_golden));
}

ZTEST(node_a_ble_codec, test_encodes_status_golden_vector)
{
	const struct node_a_ble_status status = {
		.node_id = 1U,
		.acquisition_state = 2U,
		.flags = 3U,
		.boot_id = 0x0102030405060708ULL,
		.clock_epoch = 3U,
		.status_sequence = 4U,
		.last_sample_sequence = 100U,
		.last_packet_sequence = 24U,
		.samples_acquired = 101U,
		.packets_generated = 25U,
		.sensor_fifo_overruns = 0U,
		.firmware_queue_overruns = 1U,
		.transport_backpressure_events = 2U,
		.samples_dropped_before_packetization = 3U,
		.acquisition_buffer_high_water_samples = 4U,
		.transport_queue_high_water_packets = 5U,
		.last_error_code = 6U,
	};
	uint8_t encoded[NODE_A_BLE_STATUS_SIZE];
	size_t encoded_size = 0U;

	zassert_ok(node_a_ble_encode_status(
			&status, encoded, sizeof(encoded), &encoded_size));
	zassert_equal(encoded_size, sizeof(status_golden));
	zassert_mem_equal(encoded, status_golden, sizeof(status_golden));
}

ZTEST(node_a_ble_codec, test_clock_request_rejects_crc_corruption)
{
	uint8_t corrupted[NODE_A_BLE_CLOCK_REQUEST_SIZE];
	struct node_a_ble_clock_request request = {0};

	memcpy(corrupted, clock_request_golden, sizeof(corrupted));
	corrupted[8] ^= 0x01U;

	zassert_equal(node_a_ble_decode_clock_request(
			corrupted, sizeof(corrupted), &request), -EBADMSG);
}

ZTEST_SUITE(node_a_ble_codec, NULL, NULL, NULL, NULL, NULL);
```

## src/test_ble_identity.c
```c
/*
 * Copyright (c) 2026 KineIMU Shoulder contributors
 * SPDX-License-Identifier: Apache-2.0
 */

#include <errno.h>
#include <stdint.h>
#include <string.h>

#include <zephyr/ztest.h>

#include "m1_ble_identity.h"

ZTEST(node_a_ble_identity, test_parses_exactly_40_hex_digits)
{
	const char *hex = "00112233445566778899aabbccddeeff00112233";
	const uint8_t expected[20] = {
		0x00, 0x11, 0x22, 0x33, 0x44, 0x55, 0x66, 0x77, 0x88, 0x99,
		0xaa, 0xbb, 0xcc, 0xdd, 0xee, 0xff, 0x00, 0x11, 0x22, 0x33,
	};
	uint8_t commit[20];

	zassert_ok(node_a_ble_parse_git_commit(hex, commit), NULL);
	zassert_mem_equal(commit, expected, sizeof(commit), NULL);
}

ZTEST(node_a_ble_identity, test_rejects_invalid_length_or_digit)
{
	uint8_t commit[20];

	zassert_equal(node_a_ble_parse_git_commit(
		"00112233445566778899aabbccddeeff0011223", commit), -EINVAL, NULL);
	zassert_equal(node_a_ble_parse_git_commit(
		"00112233445566778899aabbccddeeff0011223g", commit), -EINVAL, NULL);
}

ZTEST(node_a_ble_identity, test_rejects_all_zero_commit)
{
	uint8_t commit[20];

	zassert_equal(node_a_ble_parse_git_commit(
		"0000000000000000000000000000000000000000", commit), -EINVAL, NULL);
}

ZTEST_SUITE(node_a_ble_identity, NULL, NULL, NULL, NULL, NULL);
```

## src/test_ble_transport_policy.c
```c
/*
 * Copyright (c) 2026 KineIMU Shoulder contributors
 * SPDX-License-Identifier: Apache-2.0
 */

#include <errno.h>

#include <zephyr/ztest.h>

#include "m1_ble_transport_policy.h"

ZTEST(node_a_ble_transport_policy, test_accepts_required_mtu)
{
	zassert_ok(node_a_ble_transport_validate_att_mtu(127U), NULL);
}

ZTEST(node_a_ble_transport_policy, test_rejects_mtu_below_v1_requirement)
{
	zassert_equal(node_a_ble_transport_validate_att_mtu(126U), -EMSGSIZE,
		      NULL);
}

ZTEST(node_a_ble_transport_policy, test_allows_maximum_packet_at_required_mtu)
{
	const struct node_a_ble_link_state state = {
		.connected = true,
		.telemetry_notifications_enabled = true,
		.att_mtu = 127U,
	};

	zassert_true(node_a_ble_transport_can_notify(&state, 124U), NULL);
}

ZTEST(node_a_ble_transport_policy, test_rejects_payload_larger_than_mtu)
{
	const struct node_a_ble_link_state state = {
		.connected = true,
		.telemetry_notifications_enabled = true,
		.att_mtu = 127U,
	};

	zassert_false(node_a_ble_transport_can_notify(&state, 125U), NULL);
}

ZTEST(node_a_ble_transport_policy, test_rejects_unready_link)
{
	const struct node_a_ble_link_state disconnected = {
		.connected = false,
		.telemetry_notifications_enabled = true,
		.att_mtu = 127U,
	};
	const struct node_a_ble_link_state unsubscribed = {
		.connected = true,
		.telemetry_notifications_enabled = false,
		.att_mtu = 127U,
	};
	const struct node_a_ble_link_state small_mtu = {
		.connected = true,
		.telemetry_notifications_enabled = true,
		.att_mtu = 126U,
	};

	zassert_false(node_a_ble_transport_can_notify(&disconnected, 124U), NULL);
	zassert_false(node_a_ble_transport_can_notify(&unsubscribed, 124U), NULL);
	zassert_false(node_a_ble_transport_can_notify(&small_mtu, 124U), NULL);
}

ZTEST(node_a_ble_transport_policy, test_rejects_empty_payload)
{
	const struct node_a_ble_link_state state = {
		.connected = true,
		.telemetry_notifications_enabled = true,
		.att_mtu = 127U,
	};

	zassert_false(node_a_ble_transport_can_notify(&state, 0U), NULL);
}

ZTEST_SUITE(node_a_ble_transport_policy, NULL, NULL, NULL, NULL, NULL);
```

## src/test_ble_tx_completion.c
```c
/*
 * Copyright (c) 2026 KineIMU Shoulder contributors
 * SPDX-License-Identifier: Apache-2.0
 */

#include <stdint.h>

#include <zephyr/ztest.h>

#include "m1_ble_tx_completion.h"

ZTEST(node_a_ble_tx_completion, test_completion_releases_only_matching_generation)
{
	struct node_a_ble_tx_completion completion;
	uint32_t elapsed_cycles = 0U;

	node_a_ble_tx_completion_init(&completion);
	zassert_true(node_a_ble_tx_completion_begin(&completion, 7U, 100U));
	zassert_equal(node_a_ble_tx_completion_state_get(&completion),
		      NODE_A_BLE_TX_COMPLETION_IN_FLIGHT);

	zassert_false(node_a_ble_tx_completion_complete(
		&completion, 8U, 150U, &elapsed_cycles));
	zassert_equal(node_a_ble_tx_completion_state_get(&completion),
		      NODE_A_BLE_TX_COMPLETION_IN_FLIGHT);
	zassert_true(node_a_ble_tx_completion_complete(
		&completion, 7U, 150U, &elapsed_cycles));
	zassert_equal(elapsed_cycles, 50U);
	zassert_equal(node_a_ble_tx_completion_state_get(&completion),
		      NODE_A_BLE_TX_COMPLETION_AVAILABLE);
	zassert_false(node_a_ble_tx_completion_complete(
		&completion, 7U, 160U, &elapsed_cycles));
}

ZTEST(node_a_ble_tx_completion, test_cancel_holds_context_until_reclaim)
{
	struct node_a_ble_tx_completion completion;
	uint32_t elapsed_cycles = 0U;

	node_a_ble_tx_completion_init(&completion);
	zassert_true(node_a_ble_tx_completion_begin(&completion, 4U, 1000U));
	zassert_true(node_a_ble_tx_completion_cancel(
		&completion, 4U, 1020U, &elapsed_cycles));
	zassert_equal(elapsed_cycles, 20U);
	zassert_equal(node_a_ble_tx_completion_state_get(&completion),
		      NODE_A_BLE_TX_COMPLETION_CANCELED);

	/* A new connection generation cannot reuse the callback context while
	 * the old ATT buffer may still own its user_data pointer. */
	zassert_false(node_a_ble_tx_completion_begin(&completion, 5U, 2000U));
	zassert_false(node_a_ble_tx_completion_reclaim(&completion, 5U));
	zassert_true(node_a_ble_tx_completion_reclaim(&completion, 4U));
	zassert_true(node_a_ble_tx_completion_begin(&completion, 5U, 2000U));
}

ZTEST(node_a_ble_tx_completion, test_elapsed_cycles_wrap_uint32)
{
	struct node_a_ble_tx_completion completion;
	uint32_t elapsed_cycles = 0U;

	node_a_ble_tx_completion_init(&completion);
	zassert_true(node_a_ble_tx_completion_begin(
		&completion, 1U, UINT32_MAX - 5U));
	zassert_true(node_a_ble_tx_completion_complete(
		&completion, 1U, 7U, &elapsed_cycles));
	zassert_equal(elapsed_cycles, 13U);
}

ZTEST(node_a_ble_tx_completion, test_completion_contexts_are_independent)
{
	enum { TEST_CONTEXT_COUNT = 8 };
	struct node_a_ble_tx_completion completions[TEST_CONTEXT_COUNT];

	for (uint32_t index = 0U; index < TEST_CONTEXT_COUNT; index++) {
		node_a_ble_tx_completion_init(&completions[index]);
		zassert_true(node_a_ble_tx_completion_begin(
			&completions[index], index + 1U, index * 100U));
	}

	for (uint32_t index = 0U; index < TEST_CONTEXT_COUNT; index++) {
		uint32_t elapsed_cycles = 0U;

		zassert_true(node_a_ble_tx_completion_complete(
			&completions[index], index + 1U, index * 100U + 10U,
			&elapsed_cycles));
		zassert_equal(elapsed_cycles, 10U);
		zassert_equal(node_a_ble_tx_completion_state_get(&completions[index]),
			      NODE_A_BLE_TX_COMPLETION_AVAILABLE);
	}
}

ZTEST_SUITE(node_a_ble_tx_completion, NULL, NULL, NULL, NULL, NULL);
```

## src/test_ble_tx_queue.c
```c
/*
 * Copyright (c) 2026 KineIMU Shoulder contributors
 * SPDX-License-Identifier: Apache-2.0
 */

#include <errno.h>
#include <stdint.h>
#include <string.h>

#include <zephyr/kernel.h>
#include <zephyr/ztest.h>

#include "m1_ble_tx_queue.h"

static void fill_packet(uint8_t *packet, size_t size, uint8_t marker)
{
	for (size_t index = 0U; index < size; ++index) {
		packet[index] = (uint8_t)(marker + index);
	}
}

static int enqueue_marker(struct node_a_ble_tx_queue *queue,
			  uint32_t packet_sequence, uint8_t marker)
{
	uint8_t packet[NODE_A_PACKET_MAX_SIZE];

	fill_packet(packet, sizeof(packet), marker);
	return node_a_ble_tx_queue_enqueue(queue, packet, sizeof(packet),
					   packet_sequence);
}

ZTEST(node_a_ble_tx_queue, test_enqueue_copies_owned_bytes_before_source_changes)
{
	struct node_a_ble_tx_queue queue;
	struct node_a_ble_tx_packet received;
	uint8_t source[NODE_A_PACKET_MAX_SIZE];
	uint8_t expected[NODE_A_PACKET_MAX_SIZE];

	node_a_ble_tx_queue_init(&queue);
	zassert_ok(node_a_ble_tx_queue_open(&queue));
	fill_packet(source, sizeof(source), 0x20U);
	memcpy(expected, source, sizeof(expected));

	zassert_ok(node_a_ble_tx_queue_enqueue(&queue, source, sizeof(source),
					       17U));
	memset(source, 0xa5, sizeof(source));

	zassert_true(node_a_ble_tx_queue_get(&queue, &received, K_NO_WAIT));
	zassert_equal(received.size, sizeof(expected));
	zassert_equal(received.packet_sequence, 17U);
	/* The queue owns a fixed byte copy; it must not retain the producer's
	 * stack buffer after enqueue returns. */
	zassert_mem_equal(received.data, expected, sizeof(expected));
}

ZTEST(node_a_ble_tx_queue, test_accepted_packets_leave_in_fifo_sequence)
{
	struct node_a_ble_tx_queue queue;
	struct node_a_ble_tx_packet received;

	node_a_ble_tx_queue_init(&queue);
	zassert_ok(node_a_ble_tx_queue_open(&queue));
	for (uint32_t sequence = 10U; sequence < 13U; ++sequence) {
		zassert_ok(enqueue_marker(&queue, sequence, (uint8_t)sequence));
	}

	for (uint32_t sequence = 10U; sequence < 13U; ++sequence) {
		zassert_true(node_a_ble_tx_queue_get(&queue, &received, K_NO_WAIT));
		zassert_equal(received.packet_sequence, sequence);
		zassert_equal(received.data[0], (uint8_t)sequence);
	}
	zassert_false(node_a_ble_tx_queue_get(&queue, &received, K_NO_WAIT));
}

ZTEST(node_a_ble_tx_queue, test_full_queue_rejects_newest_and_preserves_fifo)
{
	struct node_a_ble_tx_queue queue;
	struct node_a_ble_tx_packet received;
	struct node_a_ble_tx_queue_stats stats;

	node_a_ble_tx_queue_init(&queue);
	zassert_ok(node_a_ble_tx_queue_open(&queue));
	for (uint32_t sequence = 0U;
	     sequence < NODE_A_BLE_TX_QUEUE_CAPACITY; ++sequence) {
		zassert_ok(enqueue_marker(&queue, sequence, (uint8_t)sequence));
	}

	zassert_equal(enqueue_marker(&queue, NODE_A_BLE_TX_QUEUE_CAPACITY,
				     0xeeU), -ENOSPC);
	node_a_ble_tx_queue_stats_get(&queue, &stats);
	zassert_equal(stats.enqueue_drops, 1U);
	zassert_equal(stats.high_water_packets,
		      NODE_A_BLE_TX_QUEUE_CAPACITY);
	zassert_equal(node_a_ble_tx_queue_take_packet_flags(&queue),
		      NODE_A_PACKET_FLAG_TRANSPORT_BACKPRESSURE);

	for (uint32_t sequence = 0U;
	     sequence < NODE_A_BLE_TX_QUEUE_CAPACITY; ++sequence) {
		zassert_true(node_a_ble_tx_queue_get(&queue, &received, K_NO_WAIT));
		/* Reject-newest policy preserves every packet already accepted. */
		zassert_equal(received.packet_sequence, sequence);
	}
}

ZTEST(node_a_ble_tx_queue, test_dequeue_then_enqueue_reuses_slot_without_reordering)
{
	struct node_a_ble_tx_queue queue;
	struct node_a_ble_tx_packet received;

	node_a_ble_tx_queue_init(&queue);
	zassert_ok(node_a_ble_tx_queue_open(&queue));
	for (uint32_t sequence = 0U;
	     sequence < NODE_A_BLE_TX_QUEUE_CAPACITY; ++sequence) {
		zassert_ok(enqueue_marker(&queue, sequence, (uint8_t)sequence));
	}
	zassert_equal(enqueue_marker(&queue, 99U, 0x99U), -ENOSPC);
	zassert_true(node_a_ble_tx_queue_get(&queue, &received, K_NO_WAIT));
	zassert_equal(received.packet_sequence, 0U);
	zassert_ok(enqueue_marker(&queue, 100U, 0x64U));

	for (uint32_t sequence = 1U;
	     sequence < NODE_A_BLE_TX_QUEUE_CAPACITY; ++sequence) {
		zassert_true(node_a_ble_tx_queue_get(&queue, &received, K_NO_WAIT));
		zassert_equal(received.packet_sequence, sequence);
	}
	zassert_true(node_a_ble_tx_queue_get(&queue, &received, K_NO_WAIT));
	zassert_equal(received.packet_sequence, 100U);
}

ZTEST(node_a_ble_tx_queue, test_disconnect_flushes_queued_packets_and_reopens_clean)
{
	struct node_a_ble_tx_queue queue;
	struct node_a_ble_tx_packet received;
	struct node_a_ble_tx_queue_stats stats;
	uint8_t rejected_data[NODE_A_PACKET_MAX_SIZE] = {0};

	node_a_ble_tx_queue_init(&queue);
	zassert_ok(node_a_ble_tx_queue_open(&queue));
	zassert_ok(enqueue_marker(&queue, 1U, 1U));
	zassert_ok(enqueue_marker(&queue, 2U, 2U));

	node_a_ble_tx_queue_disconnect(&queue);
	zassert_false(node_a_ble_tx_queue_get(&queue, &received, K_NO_WAIT));
	zassert_equal(node_a_ble_tx_queue_enqueue(
			&queue, rejected_data, sizeof(rejected_data), 3U), -ENOTCONN);
	node_a_ble_tx_queue_stats_get(&queue, &stats);
	/* Two queued packets are flushed and the post-disconnect enqueue is
	 * rejected under the same disconnect-loss accounting. */
	zassert_equal(stats.disconnect_drops, 3U);
	zassert_equal(node_a_ble_tx_queue_take_packet_flags(&queue),
		      NODE_A_PACKET_FLAG_TRANSPORT_BACKPRESSURE);

	zassert_ok(node_a_ble_tx_queue_open(&queue));
	zassert_ok(enqueue_marker(&queue, 4U, 4U));
	zassert_true(node_a_ble_tx_queue_get(&queue, &received, K_NO_WAIT));
	zassert_equal(received.packet_sequence, 4U);
	zassert_false(node_a_ble_tx_queue_get(&queue, &received, K_NO_WAIT));
}

ZTEST(node_a_ble_tx_queue, test_disconnect_invalidates_dequeued_packet_generation)
{
	struct node_a_ble_tx_queue queue;
	struct node_a_ble_tx_packet received;
	struct node_a_ble_tx_queue_stats stats;

	node_a_ble_tx_queue_init(&queue);
	zassert_ok(node_a_ble_tx_queue_open(&queue));
	zassert_ok(enqueue_marker(&queue, 7U, 7U));
	zassert_true(node_a_ble_tx_queue_get(&queue, &received, K_NO_WAIT));
	zassert_true(node_a_ble_tx_queue_packet_is_current(&queue, &received));

	node_a_ble_tx_queue_disconnect(&queue);
	zassert_false(node_a_ble_tx_queue_packet_is_current(&queue, &received));
	node_a_ble_tx_queue_note_packet_discarded(&queue, &received);
	node_a_ble_tx_queue_stats_get(&queue, &stats);
	/* A worker that already dequeued a packet must discard it after the
	 * connection generation changes; it must not retry it on reconnect. */
	zassert_equal(stats.disconnect_drops, 1U);

	zassert_ok(node_a_ble_tx_queue_open(&queue));
	zassert_ok(enqueue_marker(&queue, 8U, 8U));
	zassert_true(node_a_ble_tx_queue_get(&queue, &received, K_NO_WAIT));
	zassert_equal(received.packet_sequence, 8U);
}

ZTEST(node_a_ble_tx_queue, test_stop_flushes_and_rejects_future_packets)
{
	struct node_a_ble_tx_queue queue;
	struct node_a_ble_tx_packet received;
	struct node_a_ble_tx_queue_stats stats;

	node_a_ble_tx_queue_init(&queue);
	zassert_ok(node_a_ble_tx_queue_open(&queue));
	zassert_ok(enqueue_marker(&queue, 1U, 1U));
	node_a_ble_tx_queue_stop(&queue);

	zassert_true(node_a_ble_tx_queue_is_stopped(&queue));
	zassert_false(node_a_ble_tx_queue_get(&queue, &received, K_NO_WAIT));
	zassert_equal(enqueue_marker(&queue, 2U, 2U), -ESHUTDOWN);
	node_a_ble_tx_queue_stats_get(&queue, &stats);
	zassert_equal(stats.stop_drops, 2U);
	zassert_equal(node_a_ble_tx_queue_open(&queue), -ESHUTDOWN);
}

ZTEST(node_a_ble_tx_queue, test_high_water_remains_peak_after_drain)
{
	struct node_a_ble_tx_queue queue;
	struct node_a_ble_tx_packet received;
	struct node_a_ble_tx_queue_stats stats;

	node_a_ble_tx_queue_init(&queue);
	zassert_ok(node_a_ble_tx_queue_open(&queue));
	for (uint32_t sequence = 0U;
	     sequence < NODE_A_BLE_TX_QUEUE_CAPACITY; ++sequence) {
		zassert_ok(enqueue_marker(&queue, sequence, (uint8_t)sequence));
	}
	while (node_a_ble_tx_queue_get(&queue, &received, K_NO_WAIT)) {
	}
	zassert_ok(enqueue_marker(&queue, 20U, 20U));
	node_a_ble_tx_queue_stats_get(&queue, &stats);
	zassert_equal(stats.high_water_packets,
		      NODE_A_BLE_TX_QUEUE_CAPACITY);
}

ZTEST(node_a_ble_tx_queue, test_loss_counters_saturate_without_wrap)
{
	struct node_a_ble_tx_queue queue;
	struct node_a_ble_tx_queue_stats stats;

	node_a_ble_tx_queue_init(&queue);
	zassert_ok(node_a_ble_tx_queue_open(&queue));
	queue.stats.enqueue_drops = UINT32_MAX - 1U;
	for (uint32_t sequence = 0U;
	     sequence < NODE_A_BLE_TX_QUEUE_CAPACITY; ++sequence) {
		zassert_ok(enqueue_marker(&queue, sequence, (uint8_t)sequence));
	}
	zassert_equal(enqueue_marker(&queue, 4U, 4U), -ENOSPC);
	zassert_equal(enqueue_marker(&queue, 5U, 5U), -ENOSPC);

	node_a_ble_tx_queue_disconnect(&queue);
	node_a_ble_tx_queue_stats_get(&queue, &stats);
	zassert_equal(stats.enqueue_drops, UINT32_MAX);
	zassert_equal(stats.disconnect_drops, NODE_A_BLE_TX_QUEUE_CAPACITY);
	zassert_true(stats.counters_saturated);

	/* The terminal-stop accounting has its own saturation path. */
	node_a_ble_tx_queue_init(&queue);
	zassert_ok(node_a_ble_tx_queue_open(&queue));
	queue.stats.stop_drops = UINT32_MAX - 1U;
	zassert_ok(enqueue_marker(&queue, 8U, 8U));
	zassert_ok(enqueue_marker(&queue, 9U, 9U));
	node_a_ble_tx_queue_stop(&queue);
	node_a_ble_tx_queue_stats_get(&queue, &stats);
	zassert_equal(stats.stop_drops, UINT32_MAX);
	zassert_true(stats.counters_saturated);
}

ZTEST(node_a_ble_tx_queue, test_generation_saturation_stops_reuse)
{
	struct node_a_ble_tx_queue queue;
	struct node_a_ble_tx_packet received;
	struct node_a_ble_tx_queue_stats stats;

	node_a_ble_tx_queue_init(&queue);
	queue.connection_generation = UINT32_MAX;
	zassert_ok(node_a_ble_tx_queue_open(&queue));
	zassert_ok(enqueue_marker(&queue, 41U, 0x41U));
	zassert_true(node_a_ble_tx_queue_get(&queue, &received, K_NO_WAIT));

	node_a_ble_tx_queue_disconnect(&queue);
	zassert_true(node_a_ble_tx_queue_is_stopped(&queue));
	zassert_false(node_a_ble_tx_queue_packet_is_current(&queue, &received));
	zassert_equal(node_a_ble_tx_queue_open(&queue), -ESHUTDOWN);
	node_a_ble_tx_queue_stats_get(&queue, &stats);
	zassert_true(stats.counters_saturated);
}

ZTEST_SUITE(node_a_ble_tx_queue, NULL, NULL, NULL, NULL, NULL);
```

## src/test_m1_conn_param_control.c
```c
/*
 * Copyright (c) 2026 KineIMU Shoulder contributors
 * SPDX-License-Identifier: Apache-2.0
 */

#include <stdbool.h>
#include <stddef.h>
#include <stdint.h>
#include <string.h>

#include <zephyr/ztest.h>

#include "m1_conn_param_control.h"

#define TEST_CAPTURED_LINES 4U

struct captured_lines {
	char values[TEST_CAPTURED_LINES]
		[NODE_A_CONN_PARAM_CONTROL_LINE_CAPACITY];
	size_t lengths[TEST_CAPTURED_LINES];
	bool overflow[TEST_CAPTURED_LINES];
	size_t count;
};

static void capture_line(const char *line, size_t length, bool overflow,
			 void *context)
{
	struct captured_lines *captured = context;
	size_t index = captured->count;

	if (index >= TEST_CAPTURED_LINES) {
		return;
	}
	if (length >= NODE_A_CONN_PARAM_CONTROL_LINE_CAPACITY) {
		length = NODE_A_CONN_PARAM_CONTROL_LINE_CAPACITY - 1U;
	}
	memcpy(captured->values[index], line, length);
	captured->values[index][length] = '\0';
	captured->lengths[index] = length;
	captured->overflow[index] = overflow;
	captured->count++;
}

ZTEST(node_a_conn_param_control, test_rx_reassembles_a_fragmented_command)
{
	static const uint8_t first[] = "conn_param_request tx=17 ";
	static const uint8_t second[] = "mode=ON\r\n";
	struct node_a_conn_param_control_rx rx;
	struct captured_lines captured = {0};

	node_a_conn_param_control_rx_init(&rx);
	zassert_equal(node_a_conn_param_control_rx_push(
		&rx, first, sizeof(first) - 1U), sizeof(first) - 1U);
	zassert_equal(node_a_conn_param_control_rx_drain(
		&rx, capture_line, &captured), 0U);
	zassert_equal(node_a_conn_param_control_rx_push(
		&rx, second, sizeof(second) - 1U), sizeof(second) - 1U);
	zassert_equal(node_a_conn_param_control_rx_drain(
		&rx, capture_line, &captured), 1U);
	zassert_equal(captured.count, 1U);
	zassert_equal(captured.lengths[0],
		strlen("conn_param_request tx=17 mode=ON"));
	zassert_str_equal(captured.values[0],
		"conn_param_request tx=17 mode=ON");
	zassert_false(captured.overflow[0]);
}

ZTEST(node_a_conn_param_control, test_rx_delivers_multiple_complete_commands)
{
	static const uint8_t commands[] =
		"conn_param_request tx=1 mode=OFF\n"
		"conn_param_request tx=2 mode=ON\n";
	struct node_a_conn_param_control_rx rx;
	struct captured_lines captured = {0};

	node_a_conn_param_control_rx_init(&rx);
	zassert_equal(node_a_conn_param_control_rx_push(
		&rx, commands, sizeof(commands) - 1U), sizeof(commands) - 1U);
	zassert_equal(node_a_conn_param_control_rx_drain(
		&rx, capture_line, &captured), 2U);
	zassert_equal(captured.count, 2U);
	zassert_str_equal(captured.values[0],
		"conn_param_request tx=1 mode=OFF");
	zassert_str_equal(captured.values[1],
		"conn_param_request tx=2 mode=ON");
}

ZTEST(node_a_conn_param_control, test_rx_reports_a_line_overflow)
{
	uint8_t oversized[NODE_A_CONN_PARAM_CONTROL_LINE_CAPACITY + 8U];
	struct node_a_conn_param_control_rx rx;
	struct captured_lines captured = {0};

	memset(oversized, 'x', sizeof(oversized) - 1U);
	oversized[sizeof(oversized) - 1U] = '\n';
	node_a_conn_param_control_rx_init(&rx);
	zassert_equal(node_a_conn_param_control_rx_push(
		&rx, oversized, sizeof(oversized)), sizeof(oversized));
	zassert_equal(node_a_conn_param_control_rx_drain(
		&rx, capture_line, &captured), 1U);
	zassert_equal(captured.count, 1U);
	zassert_true(captured.overflow[0]);
}

ZTEST(node_a_conn_param_control, test_rx_reports_application_ring_overflow)
{
	uint8_t oversized[NODE_A_CONN_PARAM_CONTROL_RX_CAPACITY + 8U];
	struct node_a_conn_param_control_rx rx;
	struct captured_lines captured = {0};

	memset(oversized, 'x', sizeof(oversized));
	node_a_conn_param_control_rx_init(&rx);
	zassert_equal(node_a_conn_param_control_rx_push(
		&rx, oversized, sizeof(oversized)),
		NODE_A_CONN_PARAM_CONTROL_RX_CAPACITY);
	zassert_true(node_a_conn_param_control_rx_take_overflow(&rx));
	zassert_false(node_a_conn_param_control_rx_take_overflow(&rx));
	zassert_equal(node_a_conn_param_control_rx_drain(
		&rx, capture_line, &captured), 0U);
}

ZTEST(node_a_conn_param_control,
	test_first_complete_line_after_ring_overflow_is_delivered)
{
	uint8_t damaged[NODE_A_CONN_PARAM_CONTROL_RX_CAPACITY + 8U];
	static const uint8_t recovered[] = "HELLO session=0123456789abcdef\n";
	struct node_a_conn_param_control_rx rx;
	struct captured_lines captured = {0};

	/* The received overflow fragment ends at a line boundary; all bytes before
	 * it belong to the damaged line and may be dropped as one unit. */
	memset(damaged, 'x', sizeof(damaged));
	damaged[sizeof(damaged) - 1U] = '\n';
	node_a_conn_param_control_rx_init(&rx);
	zassert_equal(node_a_conn_param_control_rx_push(
		&rx, damaged, sizeof(damaged)),
		NODE_A_CONN_PARAM_CONTROL_RX_CAPACITY);
	zassert_true(node_a_conn_param_control_rx_take_overflow(&rx));
	zassert_equal(node_a_conn_param_control_rx_drain(
		&rx, capture_line, &captured), 0U);

	/* The next intact line must survive recovery instead of being consumed by
	 * the overflow resynchronizer. */
	zassert_equal(node_a_conn_param_control_rx_push(
		&rx, recovered, sizeof(recovered) - 1U), sizeof(recovered) - 1U);
	zassert_equal(node_a_conn_param_control_rx_drain(
		&rx, capture_line, &captured), 1U);
	zassert_equal(captured.count, 1U);
	zassert_str_equal(captured.values[0], "HELLO session=0123456789abcdef");
	zassert_false(captured.overflow[0]);
}

ZTEST(node_a_conn_param_control,
	test_complete_command_after_overflow_boundary_in_same_rx_chunk_is_delivered)
{
	static const uint8_t recovered[] = "HELLO session=0123456789abcdef\n";
	uint8_t damaged[NODE_A_CONN_PARAM_CONTROL_RX_CAPACITY + 8U +
			sizeof(recovered) - 1U];
	struct node_a_conn_param_control_rx rx;
	struct captured_lines captured = {0};
	size_t boundary = NODE_A_CONN_PARAM_CONTROL_RX_CAPACITY + 7U;

	memset(damaged, 'x', sizeof(damaged));
	damaged[boundary] = '\n';
	memcpy(&damaged[boundary + 1U], recovered, sizeof(recovered) - 1U);
	node_a_conn_param_control_rx_init(&rx);
	zassert_equal(node_a_conn_param_control_rx_push(
		&rx, damaged, sizeof(damaged)),
		NODE_A_CONN_PARAM_CONTROL_RX_CAPACITY);
	zassert_true(node_a_conn_param_control_rx_take_overflow(&rx));
	zassert_equal(node_a_conn_param_control_rx_drain(
		&rx, capture_line, &captured), 1U);
	zassert_equal(captured.count, 1U);
	zassert_str_equal(captured.values[0], "HELLO session=0123456789abcdef");
	zassert_false(captured.overflow[0]);
}

ZTEST(node_a_conn_param_control,
	test_overflow_recovery_discards_partial_consumer_line_before_next_command)
{
	static const uint8_t partial[] = "damaged-prefix";
	static const uint8_t recovered[] = "HELLO session=0123456789abcdef\n";
	uint8_t damaged[NODE_A_CONN_PARAM_CONTROL_RX_CAPACITY + 8U +
			sizeof(recovered) - 1U];
	struct node_a_conn_param_control_rx rx;
	struct captured_lines captured = {0};
	size_t boundary = NODE_A_CONN_PARAM_CONTROL_RX_CAPACITY + 7U;

	memset(damaged, 'x', sizeof(damaged));
	damaged[boundary] = '\n';
	memcpy(&damaged[boundary + 1U], recovered, sizeof(recovered) - 1U);
	node_a_conn_param_control_rx_init(&rx);
	zassert_equal(node_a_conn_param_control_rx_push(
		&rx, partial, sizeof(partial) - 1U), sizeof(partial) - 1U);
	zassert_equal(node_a_conn_param_control_rx_drain(
		&rx, capture_line, &captured), 0U);

	/* Model an RX ISR overflowing while the consumer retains an incomplete
	 * line. The overflow latch is intentionally not consumed before drain. */
	zassert_equal(node_a_conn_param_control_rx_push(
		&rx, damaged, sizeof(damaged)), NODE_A_CONN_PARAM_CONTROL_RX_CAPACITY);
	zassert_equal(node_a_conn_param_control_rx_drain(
		&rx, capture_line, &captured), 1U);
	zassert_equal(captured.count, 1U);
	zassert_str_equal(captured.values[0], "HELLO session=0123456789abcdef");
	zassert_false(captured.overflow[0]);
}

ZTEST_SUITE(node_a_conn_param_control, NULL, NULL, NULL, NULL, NULL);
```

## src/test_m1_conn_param_experiment.c
```c
/*
 * Copyright (c) 2026 KineIMU Shoulder contributors
 * SPDX-License-Identifier: Apache-2.0
 */

#include <errno.h>
#include <stdbool.h>
#include <stddef.h>
#include <stdint.h>
#include <string.h>

#include <zephyr/sys/util.h>
#include <zephyr/ztest.h>

#include "m1_conn_param_experiment.h"

struct update_request_stub {
	void *expected_connection;
	unsigned int calls;
	int return_code;
};

static int note_update_request(void *connection, void *context)
{
	struct update_request_stub *stub = context;

	if (connection != stub->expected_connection) {
		return -EINVAL;
	}
	stub->calls++;
	return stub->return_code;
}

ZTEST(node_a_conn_param_experiment, test_parses_off_and_on_commands)
{
	enum node_a_conn_param_request_mode mode =
		NODE_A_CONN_PARAM_REQUEST_ON;

	zassert_ok(node_a_conn_param_experiment_parse_command(
		"conn_param_request=OFF", strlen("conn_param_request=OFF"),
		&mode), NULL);
	zassert_equal(mode, NODE_A_CONN_PARAM_REQUEST_OFF);
	zassert_ok(node_a_conn_param_experiment_parse_command(
		"conn_param_request=ON", strlen("conn_param_request=ON"),
		&mode), NULL);
	zassert_equal(mode, NODE_A_CONN_PARAM_REQUEST_ON);
}

ZTEST(node_a_conn_param_experiment,
	test_rejects_other_commands_without_changing_output_mode)
{
	enum node_a_conn_param_request_mode mode =
		NODE_A_CONN_PARAM_REQUEST_ON;

	zassert_equal(node_a_conn_param_experiment_parse_command(
		"conn_param_request=TRUE", strlen("conn_param_request=TRUE"),
		&mode), -EINVAL, NULL);
	zassert_equal(mode, NODE_A_CONN_PARAM_REQUEST_ON);
}

ZTEST(node_a_conn_param_experiment,
	test_parses_transaction_id_and_mode_from_control_command)
{
	struct node_a_conn_param_experiment_request request = {
		.transaction_id = 0U,
		.mode = NODE_A_CONN_PARAM_REQUEST_OFF,
	};
	static const char command[] =
		"conn_param_request tx=4294967295 mode=ON";

	zassert_ok(node_a_conn_param_experiment_parse_transaction_command(
		command, sizeof(command) - 1U, &request), NULL);
	zassert_equal(request.transaction_id, UINT32_MAX);
	zassert_equal(request.mode, NODE_A_CONN_PARAM_REQUEST_ON);
}

ZTEST(node_a_conn_param_experiment,
	test_rejects_invalid_transaction_command_without_mutating_output)
{
	struct node_a_conn_param_experiment_request request = {
		.transaction_id = 7U,
		.mode = NODE_A_CONN_PARAM_REQUEST_ON,
	};
	static const char *const invalid_commands[] = {
		"conn_param_request tx=0 mode=OFF",
		"conn_param_request tx=4294967296 mode=ON",
		"conn_param_request tx=7 mode=INVALID",
		"conn_param_request tx=7 mode=OFF trailing",
		"conn_param_request tx=-7 mode=OFF",
	};

	for (size_t index = 0U;
	     index < ARRAY_SIZE(invalid_commands); index++) {
		zassert_equal(
			node_a_conn_param_experiment_parse_transaction_command(
				invalid_commands[index], strlen(invalid_commands[index]),
				&request),
			-EINVAL, "accepted invalid command: %s",
			invalid_commands[index]);
		zassert_equal(request.transaction_id, 7U);
		zassert_equal(request.mode, NODE_A_CONN_PARAM_REQUEST_ON);
	}
}

ZTEST(node_a_conn_param_experiment,
	test_new_hello_replaces_session_and_rejects_old_session_command)
{
	static const char hello_a[] = "HELLO session=0123456789abcdef";
	static const char hello_b[] = "HELLO session=fedcba9876543210";
	static const char command_a[] =
		"SET session=0123456789abcdef tx=1 mode=OFF";
	static const char command_b[] =
		"SET session=fedcba9876543210 tx=1 mode=ON";
	struct node_a_conn_param_control_session session = {0};
	struct node_a_conn_param_experiment_request request = {0};

	zassert_ok(node_a_conn_param_experiment_accept_hello(
		&session, hello_a, sizeof(hello_a) - 1U), NULL);
	zassert_true(session.active);
	zassert_str_equal(session.nonce, "0123456789abcdef");
	zassert_ok(node_a_conn_param_experiment_parse_session_command(
		command_a, sizeof(command_a) - 1U, &request), NULL);
	zassert_true(node_a_conn_param_experiment_session_matches(
		&session, &request));

	/* A HELLO on the same boot starts a new session even when tx restarts at 1. */
	zassert_ok(node_a_conn_param_experiment_accept_hello(
		&session, hello_b, sizeof(hello_b) - 1U), NULL);
	zassert_str_equal(session.nonce, "fedcba9876543210");
	zassert_false(node_a_conn_param_experiment_session_matches(
		&session, &request));
	zassert_ok(node_a_conn_param_experiment_parse_session_command(
		command_b, sizeof(command_b) - 1U, &request), NULL);
	zassert_equal(request.transaction_id, 1U);
	zassert_true(node_a_conn_param_experiment_session_matches(
		&session, &request));
}

ZTEST(node_a_conn_param_experiment,
	test_session_protocol_rejects_legacy_and_malformed_commands)
{
	struct node_a_conn_param_experiment_request request = {
		.transaction_id = 17U,
		.mode = NODE_A_CONN_PARAM_REQUEST_OFF,
	};
	static const char *const invalid_commands[] = {
		"conn_param_request tx=1 mode=ON",
		"SET session=0123456789abcdeg tx=1 mode=ON",
		"SET session=0123456789abcdef tx=0 mode=OFF",
		"SET session=0123456789abcdef tx=4294967296 mode=ON",
		"SET session=0123456789abcdef tx=1 mode=TRUE",
		"SET session=0123456789abcdef tx=1 mode=OFF trailing",
	};

	for (size_t index = 0U;
	     index < ARRAY_SIZE(invalid_commands); index++) {
		zassert_equal(
			node_a_conn_param_experiment_parse_session_command(
				invalid_commands[index], strlen(invalid_commands[index]),
				&request),
			-EINVAL, "accepted invalid command: %s",
			invalid_commands[index]);
		zassert_equal(request.transaction_id, 17U);
		zassert_equal(request.mode, NODE_A_CONN_PARAM_REQUEST_OFF);
	}
}

ZTEST(node_a_conn_param_experiment,
	test_mode_change_is_rejected_while_connected)
{
	enum node_a_conn_param_request_mode mode =
		NODE_A_CONN_PARAM_REQUEST_ON;

	zassert_ok(node_a_conn_param_experiment_set_mode(
		&mode, NODE_A_CONN_PARAM_REQUEST_OFF, false), NULL);
	zassert_equal(mode, NODE_A_CONN_PARAM_REQUEST_OFF);
	zassert_equal(node_a_conn_param_experiment_set_mode(
		&mode, NODE_A_CONN_PARAM_REQUEST_ON, true), -EBUSY, NULL);
	zassert_equal(mode, NODE_A_CONN_PARAM_REQUEST_OFF);
}

ZTEST(node_a_conn_param_experiment,
	test_duplicate_mode_changes_are_allowed_only_while_disconnected)
{
	enum node_a_conn_param_request_mode mode =
		NODE_A_CONN_PARAM_REQUEST_OFF;

	zassert_ok(node_a_conn_param_experiment_set_mode(
		&mode, NODE_A_CONN_PARAM_REQUEST_ON, false), NULL);
	zassert_ok(node_a_conn_param_experiment_set_mode(
		&mode, NODE_A_CONN_PARAM_REQUEST_ON, false), NULL);
	zassert_equal(mode, NODE_A_CONN_PARAM_REQUEST_ON);
	zassert_equal(node_a_conn_param_experiment_set_mode(
		&mode, NODE_A_CONN_PARAM_REQUEST_OFF, true), -EBUSY, NULL);
	zassert_equal(mode, NODE_A_CONN_PARAM_REQUEST_ON);
}

ZTEST(node_a_conn_param_experiment,
	test_off_connection_does_not_call_update_api)
{
	struct update_request_stub stub = {
		.expected_connection = (void *)0x1234U,
		.return_code = 0,
	};
	bool invoked = true;

	zassert_ok(node_a_conn_param_experiment_on_connect(
		NODE_A_CONN_PARAM_REQUEST_OFF, stub.expected_connection,
		note_update_request, &stub, &invoked), NULL);
	zassert_false(invoked);
	zassert_equal(stub.calls, 0U);
}

ZTEST(node_a_conn_param_experiment,
	test_on_connection_calls_update_api_once_and_preserves_result)
{
	struct update_request_stub stub = {
		.expected_connection = (void *)0x5678U,
		.return_code = -EALREADY,
	};
	bool invoked = false;

	zassert_equal(node_a_conn_param_experiment_on_connect(
		NODE_A_CONN_PARAM_REQUEST_ON, stub.expected_connection,
		note_update_request, &stub, &invoked), -EALREADY, NULL);
	zassert_true(invoked);
	zassert_equal(stub.calls, 1U);
}

ZTEST_SUITE(node_a_conn_param_experiment, NULL, NULL, NULL, NULL, NULL);
```

## src/test_register_snapshot.c
```c
/*
 * Copyright (c) 2026 KineIMU Shoulder contributors
 * SPDX-License-Identifier: Apache-2.0
 */

#include <errno.h>
#include <stdint.h>
#include <string.h>

#include <zephyr/device.h>
#include <zephyr/drivers/i2c.h>
#include <zephyr/ztest.h>

typedef int (*node_a_register_burst_read_fn)(
	const struct i2c_dt_spec *spec, uint8_t start_addr, uint8_t *buf,
	uint32_t num_bytes);

int node_a_imu_read_register_snapshot(
	const struct i2c_dt_spec *spec, node_a_register_burst_read_fn burst_read,
	uint8_t snapshot[19]);

static const uint8_t expected_start_addresses[] = {
	0x06U, 0x0dU, 0x10U, 0x5eU,
};
static const uint32_t expected_lengths[] = {5U, 2U, 10U, 2U};
static size_t call_count;
static size_t fail_call;
static int read_error;

static int fake_register_burst_read(const struct i2c_dt_spec *spec,
					uint8_t start_addr, uint8_t *buf,
					uint32_t num_bytes)
{
	ARG_UNUSED(spec);
	if (call_count >= ARRAY_SIZE(expected_start_addresses)) {
		return -EOVERFLOW;
	}
	if ((start_addr != expected_start_addresses[call_count]) ||
	    (num_bytes != expected_lengths[call_count])) {
		return -EINVAL;
	}
	if (call_count == fail_call) {
		call_count++;
		return read_error;
	}

	for (uint32_t index = 0U; index < num_bytes; ++index) {
		buf[index] = (uint8_t)(10U * call_count + index);
	}
	call_count++;
	return 0;
}

/* RED-phase fallback. The production acquisition adapter replaces this. */
__weak int node_a_imu_read_register_snapshot(
	const struct i2c_dt_spec *spec, node_a_register_burst_read_fn burst_read,
	uint8_t snapshot[19])
{
	ARG_UNUSED(spec);
	ARG_UNUSED(burst_read);
	ARG_UNUSED(snapshot);
	return -ENOSYS;
}

static void reset_fake(void)
{
	call_count = 0U;
	fail_call = SIZE_MAX;
	read_error = -EIO;
}

ZTEST(node_a_register_snapshot, test_reads_snapshot_in_contract_order)
{
	const struct i2c_dt_spec spec = {0};
	uint8_t snapshot[19];

	reset_fake();
	memset(snapshot, 0U, sizeof(snapshot));
	zassert_ok(node_a_imu_read_register_snapshot(
		&spec, fake_register_burst_read, snapshot), NULL);
	zassert_equal(call_count, ARRAY_SIZE(expected_start_addresses), NULL);
	zassert_equal(snapshot[0], 0U, NULL);
	zassert_equal(snapshot[4], 4U, NULL);
	zassert_equal(snapshot[5], 10U, NULL);
	zassert_equal(snapshot[6], 11U, NULL);
	zassert_equal(snapshot[7], 20U, NULL);
	zassert_equal(snapshot[16], 29U, NULL);
	zassert_equal(snapshot[17], 30U, NULL);
	zassert_equal(snapshot[18], 31U, NULL);
}

ZTEST(node_a_register_snapshot, test_read_error_preserves_snapshot)
{
	const struct i2c_dt_spec spec = {0};
	uint8_t snapshot[19];
	uint8_t expected[19];

	reset_fake();
	fail_call = 2U;
	memset(snapshot, 0xa5, sizeof(snapshot));
	memset(expected, 0xa5, sizeof(expected));
	zassert_equal(node_a_imu_read_register_snapshot(
		&spec, fake_register_burst_read, snapshot), -EIO, NULL);
	zassert_mem_equal(snapshot, expected, sizeof(snapshot), NULL);
	zassert_equal(call_count, 3U, NULL);
}

ZTEST_SUITE(node_a_register_snapshot, NULL, NULL, NULL, NULL, NULL);
```
