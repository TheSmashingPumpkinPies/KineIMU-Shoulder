## CMakeLists.txt
```
cmake_minimum_required(VERSION 3.20.0)

find_package(Zephyr REQUIRED HINTS $ENV{ZEPHYR_BASE})
project(kineimu_shoulder_node_a_bringup)

set(KINEIMU_NODE_ID "1" CACHE STRING
	"Logical node identity: 1 for Node A or 2 for Node B")
if(NOT KINEIMU_NODE_ID STREQUAL "1" AND NOT KINEIMU_NODE_ID STREQUAL "2")
	message(FATAL_ERROR "KINEIMU_NODE_ID must be 1 (A) or 2 (B)")
endif()

target_compile_definitions(app PRIVATE KINEIMU_NODE_ID=${KINEIMU_NODE_ID})

target_sources(app PRIVATE src/main.c src/acquisition.c src/counters.c
	       src/identity.c src/lsm6dsl_fifo.c src/lsm6dsl_raw.c src/packet.c
	       src/sample_queue.c
	       src/timestamp.c)
```

## prj.conf
```kconfig
CONFIG_STDOUT_CONSOLE=y
CONFIG_PRINTK=y
CONFIG_CBPRINTF_FP_SUPPORT=y
CONFIG_UART_LINE_CTRL=y
CONFIG_I2C=y
CONFIG_SENSOR=y
CONFIG_LSM6DSL=y
CONFIG_LSM6DSL_TRIGGER_GLOBAL_THREAD=y
```

## app.overlay
```dts
/*
 * The XIAO Sense board powers the IMU from a boot-on fixed regulator. Zephyr
 * 4.4.0 does not apply startup-delay-us when that regulator is initialized in
 * the already-enabled path, so initialize the sensor from main after a
 * measured-safe power-up interval.
 */
&lsm6ds3tr_c {
	zephyr,deferred-init;
};
```

## src/main.c
```c
/*
 * Copyright (c) 2026 KineIMU Shoulder contributors
 * SPDX-License-Identifier: Apache-2.0
 */

#include <errno.h>

#include <zephyr/device.h>
#include <zephyr/drivers/gpio.h>
#include <zephyr/drivers/i2c.h>
#include <zephyr/drivers/sensor.h>
#include <zephyr/drivers/uart.h>
#include <zephyr/kernel.h>
#include <zephyr/sys/printk.h>
#include <hal/nrf_ficr.h>

#include "acquisition.h"
#include "counters.h"
#include "identity.h"
#include "lsm6dsl_fifo.h"
#include "lsm6dsl_raw.h"
#include "node_config.h"
#include "packet.h"
#include "sample_queue.h"
#include "timestamp.h"

#define IMU_NODE DT_NODELABEL(lsm6ds3tr_c)
#define IMU_POWER_UP_DELAY K_MSEC(50)
#define LSM6DS3TR_C_REG_INT1_CTRL 0x0d
#define LSM6DS3TR_C_REG_WHO_AM_I 0x0f
#define LSM6DS3TR_C_REG_CTRL1_XL 0x10
#define LSM6DS3TR_C_REG_CTRL2_G 0x11
#define NODE_A_PACKET_BATCH_SIZE NODE_A_PACKET_MAX_SAMPLES
#define NODE_A_PACKET_GATHER_TIMEOUT K_MSEC(20)

BUILD_ASSERT(DT_NODE_HAS_COMPAT(DT_CHOSEN(zephyr_console),
				zephyr_cdc_acm_uart),
		     "bring-up console must be CDC ACM UART");

static const struct device *const imu = DEVICE_DT_GET(IMU_NODE);
static const struct i2c_dt_spec imu_i2c = I2C_DT_SPEC_GET(IMU_NODE);
static const struct gpio_dt_spec imu_drdy_gpio =
	GPIO_DT_SPEC_GET(IMU_NODE, irq_gpios);
static const struct device *const console =
	DEVICE_DT_GET(DT_CHOSEN(zephyr_console));
static struct node_a_drdy_timestamp drdy_timestamp;
static struct node_a_stream_counters stream_counters;
static struct node_a_sample_queue sample_queue;
static struct node_a_lsm6dsl_fifo_observer fifo_observer;
static struct node_a_lsm6dsl_fifo_status last_fifo_status;
static bool have_fifo_status;
static volatile bool binary_streaming;
static bool first_valid_sample_pending = true;

static bool fifo_status_changed(
	const struct node_a_lsm6dsl_fifo_status *first,
	const struct node_a_lsm6dsl_fifo_status *second)
{
	return (first->status1_raw != second->status1_raw) ||
		(first->status2_raw != second->status2_raw) ||
		(first->unread_words != second->unread_words) ||
		(first->watermark != second->watermark) ||
		(first->overrun != second->overrun) ||
		(first->full != second->full) ||
		(first->empty != second->empty);
}

static void data_ready_handler(const struct device *dev,
			       const struct sensor_trigger *trigger)
{
	struct node_a_imu_sample sample = {0};
	int rc;

	ARG_UNUSED(dev);
	ARG_UNUSED(trigger);

	/* The GPIO callback captured this event's monotonic uptime ticks before the
	 * LSM6DSL driver deferred sample I/O to its global work queue.
	 */
	if (!node_a_drdy_timestamp_take(&drdy_timestamp,
					&sample.timestamp_us)) {
		if (!binary_streaming) {
			printk("Node %s: data-ready event missing ISR timestamp\n",
			       KINEIMU_NODE_LABEL);
		}
		return;
	}

	rc = node_a_lsm6dsl_read_raw(&imu_i2c, i2c_burst_read_dt, &sample);
	if (rc < 0) {
		if (!binary_streaming) {
			printk("Node %s: data-ready sample read failed rc=%d\n",
			       KINEIMU_NODE_LABEL, rc);
		}
		return;
	}

	struct node_a_lsm6dsl_fifo_status fifo_status;
	uint32_t overruns_before = fifo_observer.sensor_fifo_overruns;

	rc = node_a_lsm6dsl_read_fifo_status(
		&imu_i2c, i2c_burst_read_dt, &fifo_status);
	if (rc < 0) {
		/* FIFO diagnostics must not turn a coherent direct-register sample into
		 * a dropped sample. The status read error remains visible on the CDC
		 * console for the later transport/error accounting slice.
		 */
		if (!binary_streaming) {
			printk("Node %s: sensor FIFO status read failed rc=%d\n",
			       KINEIMU_NODE_LABEL, rc);
		}
	} else {
		node_a_lsm6dsl_fifo_observe(&fifo_observer, &fifo_status);
		if (!have_fifo_status ||
		    fifo_status_changed(&fifo_status, &last_fifo_status) ||
		    (fifo_observer.sensor_fifo_overruns != overruns_before)) {
			if (!binary_streaming) {
				printk("Node %s: sensor FIFO status FIFO_STATUS1=0x%02x "
				       "FIFO_STATUS2=0x%02x unread_words=%u watermark=%d "
				       "overrun=%d full=%d empty=%d overrun_count=%u "
				       "saturated=%d\n", KINEIMU_NODE_LABEL,
				       fifo_status.status1_raw, fifo_status.status2_raw,
				       fifo_status.unread_words, fifo_status.watermark,
				       fifo_status.overrun, fifo_status.full, fifo_status.empty,
				       fifo_observer.sensor_fifo_overruns,
				       fifo_observer.counters_saturated);
			}
			last_fifo_status = fifo_status;
			have_fifo_status = true;
		}
	}

	if (!node_a_imu_startup_sample_should_publish(
			&first_valid_sample_pending)) {
		return;
	}

	sample.clock_epoch = stream_counters.clock_epoch;
	sample.sample_sequence =
		node_a_counters_take_sample(&stream_counters);

	/* Drop the newest sample when the fixed queue is full. Its already-issued
	 * sequence makes the loss visible to the later packet/host sequence audit.
	 */
	node_a_sample_queue_put(&sample_queue, &sample);
}

static void node_a_usb_write(const uint8_t *buffer, size_t size)
{
	for (size_t index = 0U; index < size; ++index) {
		uart_poll_out(console, buffer[index]);
	}
}

int main(void)
{
	struct node_a_imu_registers registers;
	uint32_t dtr = 0;
	int ret;

	/* USB CDC drops early console output before the host opens the port. The
	 * bring-up probe waits so its one-shot configuration audit is observable.
	 */
	while (!dtr) {
		uart_line_ctrl_get(console, UART_LINE_CTRL_DTR, &dtr);
		k_sleep(K_MSEC(100));
	}

	const uint32_t ficr_deviceid0 =
		nrf_ficr_deviceid_get(NRF_FICR, 0U);
	const uint32_t ficr_deviceid1 =
		nrf_ficr_deviceid_get(NRF_FICR, 1U);
	const uint64_t hardware_device_id =
		node_a_ficr_device_id_from_words(ficr_deviceid0, ficr_deviceid1);
	printk("Node %s: nRF52840 FICR DEVICEID[0]=0x%08x "
	       "DEVICEID[1]=0x%08x hardware_device_id=0x%08x%08x\n",
	       KINEIMU_NODE_LABEL, ficr_deviceid0, ficr_deviceid1,
	       (uint32_t)(hardware_device_id >> 32),
	       (uint32_t)hardware_device_id);

	k_sleep(IMU_POWER_UP_DELAY);
	ret = device_init(imu);
	printk("KineIMU Shoulder Node %s: IMU init rc=%d ready=%d\n",
	       KINEIMU_NODE_LABEL, ret, device_is_ready(imu));
	if ((ret < 0) || !device_is_ready(imu)) {
		return ret;
	}

	ret = node_a_drdy_timestamp_attach(&drdy_timestamp, &imu_drdy_gpio);
	if (ret < 0) {
		printk("Node %s: data-ready timestamp setup failed rc=%d\n",
		       KINEIMU_NODE_LABEL, ret);
		return ret;
	}
	node_a_counters_start(&stream_counters, 0U);
	node_a_sample_queue_init(&sample_queue);
	node_a_lsm6dsl_fifo_observer_init(&fifo_observer);

	ret = node_a_imu_configure(imu, data_ready_handler);
	if (ret < 0) {
		printk("Node %s: IMU acquisition setup failed rc=%d\n",
		       KINEIMU_NODE_LABEL, ret);
		return ret;
	}

	ret = i2c_reg_read_byte_dt(&imu_i2c, LSM6DS3TR_C_REG_WHO_AM_I,
				   &registers.who_am_i);
	if (ret == 0) {
		ret = i2c_reg_read_byte_dt(&imu_i2c,
					   LSM6DS3TR_C_REG_INT1_CTRL,
					   &registers.int1_ctrl);
	}
	if (ret == 0) {
		ret = i2c_reg_read_byte_dt(&imu_i2c,
					   LSM6DS3TR_C_REG_CTRL1_XL,
					   &registers.ctrl1_xl);
	}
	if (ret == 0) {
		ret = i2c_reg_read_byte_dt(&imu_i2c,
					   LSM6DS3TR_C_REG_CTRL2_G,
					   &registers.ctrl2_g);
	}
	if (ret < 0) {
		printk("Node %s: IMU register audit read failed rc=%d\n",
		       KINEIMU_NODE_LABEL, ret);
		return ret;
	}

	printk("Node %s: IMU registers WHO_AM_I=0x%02x INT1_CTRL=0x%02x "
	       "CTRL1_XL=0x%02x CTRL2_G=0x%02x match=%d\n",
	       KINEIMU_NODE_LABEL, registers.who_am_i, registers.int1_ctrl,
	       registers.ctrl1_xl,
	       registers.ctrl2_g,
	       node_a_imu_registers_match_config(&registers));
	if (!node_a_imu_registers_match_config(&registers)) {
		return -EIO;
	}

	printk("Node %s: data-ready acquisition armed at 104 Hz, +/-4 g, +/-500 dps\n",
	       KINEIMU_NODE_LABEL);
	printk("Node %s: v1 USB packet stream node_id=%u batch_max=%u\n",
	       KINEIMU_NODE_LABEL, NODE_A_PACKET_NODE_ID,
	       NODE_A_PACKET_MAX_SAMPLES);
	printk("Node %s: first valid startup DRDY frame drained before sequence zero\n",
	       KINEIMU_NODE_LABEL);
	binary_streaming = true;

	bool have_previous_sample = false;
	uint32_t previous_sample_sequence = 0U;
	while (true) {
		struct node_a_imu_sample samples[NODE_A_PACKET_BATCH_SIZE];
		uint8_t encoded[NODE_A_PACKET_MAX_SIZE];
		size_t sample_count = 1U;
		size_t encoded_size = 0U;
		uint16_t packet_flags;
		int encode_rc;

		if (!node_a_sample_queue_get(&sample_queue, &samples[0], K_FOREVER)) {
			continue;
		}
		while (sample_count < NODE_A_PACKET_BATCH_SIZE &&
		       node_a_sample_queue_get(&sample_queue,
						&samples[sample_count],
						NODE_A_PACKET_GATHER_TIMEOUT)) {
			sample_count++;
		}

		packet_flags = node_a_lsm6dsl_fifo_take_packet_flags(&fifo_observer) |
			node_a_sample_queue_take_packet_flags(&sample_queue);
		if (node_a_packet_samples_have_discontinuity(
				samples, sample_count, have_previous_sample,
				previous_sample_sequence)) {
			packet_flags |= NODE_A_PACKET_FLAG_DISCONTINUITY;
		}

		const struct node_a_sample_packet packet = {
			.node_id = NODE_A_PACKET_NODE_ID,
			.packet_sequence = node_a_counters_take_packet(&stream_counters),
			.clock_epoch = samples[0].clock_epoch,
			.flags = packet_flags,
			.samples = samples,
			.sample_count = sample_count,
		};
		encode_rc = node_a_packet_encode(&packet, encoded,
						sizeof(encoded), &encoded_size);
		if (encode_rc < 0) {
			/* A valid queue item should always satisfy the packet contract. Do
			 * not append text after binary streaming has started if that invariant
			 * is ever violated.
			 */
			return encode_rc;
		}
		node_a_usb_write(encoded, encoded_size);
		have_previous_sample = true;
		previous_sample_sequence =
			samples[sample_count - 1U].sample_sequence;
	}

	return 0;
}
```

## src/acquisition.c
```c
/*
 * Copyright (c) 2026 KineIMU Shoulder contributors
 * SPDX-License-Identifier: Apache-2.0
 */

#include <errno.h>
#include <string.h>

#include <zephyr/drivers/gpio.h>
#include <zephyr/drivers/sensor.h>
#include <zephyr/kernel.h>

#include "acquisition.h"
#include "lsm6dsl_raw.h"
#include "node_config.h"
#define NODE_A_ODR_HZ 104

#define NODE_A_WHO_AM_I 0x6a
#define NODE_A_INT1_DRDY_MASK 0x03
#define NODE_A_CTRL1_XL_CONFIG_MASK 0xfc
#define NODE_A_CTRL1_XL_CONFIG 0x48
#define NODE_A_CTRL2_G_CONFIG_MASK 0xfe
#define NODE_A_CTRL2_G_CONFIG 0x44

struct node_a_register_snapshot_segment {
	uint8_t start_addr;
	uint8_t length;
};

static const struct node_a_register_snapshot_segment
	node_a_register_snapshot_segments[] = {
	{.start_addr = 0x06U, .length = 5U},
	{.start_addr = 0x0dU, .length = 2U},
	{.start_addr = 0x10U, .length = 10U},
	{.start_addr = 0x5eU, .length = 2U},
};

/* The Zephyr LSM6DSL driver retains this pointer after sensor_trigger_set(). */
static const struct sensor_trigger node_a_data_ready_trigger = {
	.type = SENSOR_TRIG_DATA_READY,
	.chan = SENSOR_CHAN_ACCEL_XYZ,
};

bool node_a_imu_startup_sample_should_publish(bool *first_valid_sample_pending)
{
	if (*first_valid_sample_pending) {
		*first_valid_sample_pending = false;
		return false;
	}
	return true;
}

int node_a_imu_arm_data_ready(const struct device *imu,
				 sensor_trigger_handler_t data_ready_handler)
{
	if ((imu == NULL) || (data_ready_handler == NULL)) {
		return -EINVAL;
	}

	return sensor_trigger_set(imu, &node_a_data_ready_trigger,
					 data_ready_handler);
}

int node_a_imu_disarm_data_ready(const struct device *imu)
{
	if (imu == NULL) {
		return -EINVAL;
	}

	return sensor_trigger_set(imu, &node_a_data_ready_trigger, NULL);
}

int node_a_imu_wait_data_ready_inactive(
	const struct gpio_dt_spec *drdy_gpio, uint32_t timeout_ms)
{
	const int64_t deadline_ms = k_uptime_get() + (int64_t)timeout_ms;

	if ((drdy_gpio == NULL) || (drdy_gpio->port == NULL)) {
		return -EINVAL;
	}
	if (!gpio_is_ready_dt(drdy_gpio)) {
		return -ENODEV;
	}

	while (true) {
		const int active = gpio_pin_get_dt(drdy_gpio);

		if (active < 0) {
			return active;
		}
		if (active == 0) {
			return 0;
		}
		if (k_uptime_get() >= deadline_ms) {
			return -ETIMEDOUT;
		}

		k_sleep(K_MSEC(1));
	}
}

int node_a_imu_drain_data_ready(
	const struct i2c_dt_spec *spec,
	node_a_imu_register_burst_read_fn burst_read)
{
	struct node_a_imu_sample discarded_sample = {0};

	if ((spec == NULL) || (burst_read == NULL)) {
		return -EINVAL;
	}

	/* Reading the output frame clears a pending level without publishing a
	 * pre-stream sample. The next trigger can then be a real DRDY edge with an
	 * ISR timestamp.
	 */
	return node_a_lsm6dsl_read_raw(spec, burst_read, &discarded_sample);
}

static void node_a_imu_rearm_set_state(
	struct node_a_imu_rearm_result *result,
	enum node_a_imu_rearm_state state)
{
	if (result != NULL) {
		result->state = state;
	}
}

int node_a_imu_quiesce_and_arm_data_ready(
	const struct device *imu,
	const struct gpio_dt_spec *drdy_gpio,
	const struct i2c_dt_spec *spec,
	node_a_imu_register_burst_read_fn burst_read,
	sensor_trigger_handler_t data_ready_handler,
	void (*reset_pending_timestamp)(void *context),
	void *reset_context,
	uint32_t quiet_timeout_ms,
	uint8_t max_attempts,
	struct node_a_imu_rearm_result *result)
{
	int rc = -ETIMEDOUT;

	if (result != NULL) {
		result->state = NODE_A_IMU_REARM_IDLE;
		result->attempts = 0U;
		result->race_retries = 0U;
	}

	if ((imu == NULL) || (drdy_gpio == NULL) || (spec == NULL) ||
	    (burst_read == NULL) || (data_ready_handler == NULL) ||
	    (reset_pending_timestamp == NULL) || (max_attempts == 0U)) {
		node_a_imu_rearm_set_state(result, NODE_A_IMU_REARM_FATAL);
		return -EINVAL;
	}

	for (uint8_t attempt = 0U; attempt < max_attempts; ++attempt) {
		if (result != NULL) {
			result->attempts = (uint8_t)(attempt + 1U);
		}

		node_a_imu_rearm_set_state(result, NODE_A_IMU_REARM_DISARMING);
		rc = node_a_imu_disarm_data_ready(imu);
		if (rc < 0) {
			goto fatal;
		}

		node_a_imu_rearm_set_state(result, NODE_A_IMU_REARM_DRAINING);
		rc = node_a_imu_drain_data_ready(spec, burst_read);
		if (rc < 0) {
			goto fatal;
		}

		node_a_imu_rearm_set_state(
			result, NODE_A_IMU_REARM_WAITING_INACTIVE);
		rc = node_a_imu_wait_data_ready_inactive(
			drdy_gpio, quiet_timeout_ms);
		if (rc < 0) {
			/* A line that remained active is retryable. Other failures are
			 * configuration or GPIO errors and are immediately fatal. */
			if (rc == -ETIMEDOUT) {
				continue;
			}
			goto fatal;
		}

		/* Only clear timestamp state after the line is observed inactive. Any
		 * event before this point belongs to the quiescing boundary. */
		reset_pending_timestamp(reset_context);

		node_a_imu_rearm_set_state(result, NODE_A_IMU_REARM_ARMING);
		rc = node_a_imu_arm_data_ready(imu, data_ready_handler);
		if (rc < 0) {
			goto fatal;
		}

		/* The in-tree LSM6DSL driver checks the level while enabling its GPIO
		 * interrupt. A high result means that the check-to-arm interval won
		 * the race and the arm must be retried from a disarmed state. */
		node_a_imu_rearm_set_state(result, NODE_A_IMU_REARM_VERIFYING);
		rc = node_a_imu_wait_data_ready_inactive(drdy_gpio, 0U);
		if (rc == 0) {
			node_a_imu_rearm_set_state(result, NODE_A_IMU_REARM_ARMED);
			return 0;
		}
		if (rc != -ETIMEDOUT) {
			goto fatal;
		}
		if (result != NULL) {
			result->race_retries++;
		}
	}

	rc = -ETIMEDOUT;

fatal:
	node_a_imu_rearm_set_state(result, NODE_A_IMU_REARM_FATAL);
	return rc;
}

int node_a_imu_configure(const struct device *imu,
			 sensor_trigger_handler_t data_ready_handler)
{
	struct sensor_value accel_range;
	struct sensor_value gyro_range;
	const struct sensor_value odr = {
		.val1 = NODE_A_ODR_HZ,
		.val2 = 0,
	};
	int rc;

	if ((imu == NULL) || (data_ready_handler == NULL)) {
		return -EINVAL;
	}

	/* sensor_attr_set() requires SI values at the Zephyr boundary. */
	sensor_g_to_ms2(NODE_A_ACCEL_RANGE_G, &accel_range);
	sensor_degrees_to_rad(NODE_A_GYRO_RANGE_DPS, &gyro_range);

	rc = sensor_attr_set(imu, SENSOR_CHAN_ACCEL_XYZ,
			     SENSOR_ATTR_FULL_SCALE, &accel_range);
	if (rc < 0) {
		return rc;
	}

	rc = sensor_attr_set(imu, SENSOR_CHAN_GYRO_XYZ,
			     SENSOR_ATTR_FULL_SCALE, &gyro_range);
	if (rc < 0) {
		return rc;
	}

	rc = sensor_attr_set(imu, SENSOR_CHAN_ACCEL_XYZ,
			     SENSOR_ATTR_SAMPLING_FREQUENCY, &odr);
	if (rc < 0) {
		return rc;
	}

	rc = sensor_attr_set(imu, SENSOR_CHAN_GYRO_XYZ,
			     SENSOR_ATTR_SAMPLING_FREQUENCY, &odr);
	if (rc < 0) {
		return rc;
	}

	return node_a_imu_arm_data_ready(imu, data_ready_handler);
}

int node_a_imu_read_register_snapshot(
	const struct i2c_dt_spec *spec,
	node_a_imu_register_burst_read_fn burst_read,
	uint8_t snapshot[19])
{
	uint8_t staged[19];
	size_t offset = 0U;

	if ((spec == NULL) || (burst_read == NULL) || (snapshot == NULL)) {
		return -EINVAL;
	}

	for (size_t index = 0U;
	     index < ARRAY_SIZE(node_a_register_snapshot_segments); ++index) {
		const struct node_a_register_snapshot_segment *segment =
			&node_a_register_snapshot_segments[index];
		int rc = burst_read(spec, segment->start_addr, &staged[offset],
					segment->length);

		if (rc < 0) {
			return rc;
		}
		offset += segment->length;
	}

	memcpy(snapshot, staged, sizeof(staged));
	return 0;
}

bool node_a_imu_registers_match_config(
	const struct node_a_imu_registers *registers)
{
	if (registers == NULL) {
		return false;
	}

	return (registers->who_am_i == NODE_A_WHO_AM_I) &&
	       ((registers->int1_ctrl & NODE_A_INT1_DRDY_MASK) ==
		NODE_A_INT1_DRDY_MASK) &&
	       ((registers->ctrl1_xl & NODE_A_CTRL1_XL_CONFIG_MASK) ==
		NODE_A_CTRL1_XL_CONFIG) &&
	       ((registers->ctrl2_g & NODE_A_CTRL2_G_CONFIG_MASK) ==
		NODE_A_CTRL2_G_CONFIG);
}
```

## src/acquisition.h
```c
/*
 * Copyright (c) 2026 KineIMU Shoulder contributors
 * SPDX-License-Identifier: Apache-2.0
 */

#ifndef KINEIMU_NODE_A_ACQUISITION_H_
#define KINEIMU_NODE_A_ACQUISITION_H_

#include <stdbool.h>
#include <stdint.h>

#include <zephyr/device.h>
#include <zephyr/drivers/gpio.h>
#include <zephyr/drivers/i2c.h>
#include <zephyr/drivers/sensor.h>

typedef int (*node_a_imu_register_burst_read_fn)(
	const struct i2c_dt_spec *spec, uint8_t start_addr, uint8_t *buf,
	uint32_t num_bytes);

struct node_a_imu_registers {
	uint8_t who_am_i;
	uint8_t int1_ctrl;
	uint8_t ctrl1_xl;
	uint8_t ctrl2_g;
};

struct node_a_imu_sample {
	uint32_t clock_epoch;
	uint32_t sample_sequence;
	uint64_t timestamp_us;
	uint16_t flags;
	int16_t accel_raw[3];
	int16_t gyro_raw[3];
};

enum node_a_imu_rearm_state {
	NODE_A_IMU_REARM_IDLE,
	NODE_A_IMU_REARM_DISARMING,
	NODE_A_IMU_REARM_DRAINING,
	NODE_A_IMU_REARM_WAITING_INACTIVE,
	NODE_A_IMU_REARM_ARMING,
	NODE_A_IMU_REARM_VERIFYING,
	NODE_A_IMU_REARM_ARMED,
	NODE_A_IMU_REARM_FATAL,
};

struct node_a_imu_rearm_result {
	enum node_a_imu_rearm_state state;
	uint8_t attempts;
	uint8_t race_retries;
};

int node_a_imu_configure(const struct device *imu,
			 sensor_trigger_handler_t data_ready_handler);

int node_a_imu_arm_data_ready(const struct device *imu,
				 sensor_trigger_handler_t data_ready_handler);

/* Disable the driver's deferred data-ready callback before clearing a
 * pending level at the stream boundary. */
int node_a_imu_disarm_data_ready(const struct device *imu);

/* The in-tree LSM6DSL driver may synchronously notice an already-active INT1
 * level while arming. Do not arm until the level has returned inactive. */
int node_a_imu_wait_data_ready_inactive(
	const struct gpio_dt_spec *drdy_gpio, uint32_t timeout_ms);

/* Read and discard one output frame to release a pending DRDY level. */
int node_a_imu_drain_data_ready(
	const struct i2c_dt_spec *spec,
	node_a_imu_register_burst_read_fn burst_read);

/* Quiesce, drain, arm, and verify the DRDY line as one bounded operation.
 * The caller supplies the timestamp reset so the acquisition boundary can
 * discard stale GPIO events without coupling this module to stream state. */
int node_a_imu_quiesce_and_arm_data_ready(
	const struct device *imu,
	const struct gpio_dt_spec *drdy_gpio,
	const struct i2c_dt_spec *spec,
	node_a_imu_register_burst_read_fn burst_read,
	sensor_trigger_handler_t data_ready_handler,
	void (*reset_pending_timestamp)(void *context),
	void *reset_context,
	uint32_t quiet_timeout_ms,
	uint8_t max_attempts,
	struct node_a_imu_rearm_result *result);

int node_a_imu_read_register_snapshot(
	const struct i2c_dt_spec *spec,
	node_a_imu_register_burst_read_fn burst_read,
	uint8_t snapshot[19]);

bool node_a_imu_registers_match_config(
	const struct node_a_imu_registers *registers);

/* The first valid DRDY frame can follow a partial ODR interval after arming.
 * Drain it before issuing sample sequence zero for the USB bench stream. */
bool node_a_imu_startup_sample_should_publish(bool *first_valid_sample_pending);

#endif /* KINEIMU_NODE_A_ACQUISITION_H_ */
```

## src/acquisition_trace.c
```c
/*
 * Copyright (c) 2026 KineIMU Shoulder contributors
 * SPDX-License-Identifier: Apache-2.0
 */

#include <string.h>

#include <zephyr/kernel.h>

#include "acquisition_trace.h"

static void saturating_increment(uint32_t *counter, bool *saturated)
{
	if (*counter < UINT32_MAX) {
		(*counter)++;
	}
	if (*counter == UINT32_MAX) {
		*saturated = true;
	}
}

void node_a_acquisition_trace_init(struct node_a_acquisition_trace *trace)
{
	if (trace != NULL) {
		memset(trace, 0, sizeof(*trace));
	}
}

void node_a_acquisition_trace_note_callback_entry(
	struct node_a_acquisition_trace *trace)
{
	k_spinlock_key_t key;

	if (trace == NULL) {
		return;
	}
	key = k_spin_lock(&trace->lock);
	saturating_increment(&trace->callback_entries, &trace->counters_saturated);
	k_spin_unlock(&trace->lock, key);
}

void node_a_acquisition_trace_note_pre_acquisition(
	struct node_a_acquisition_trace *trace)
{
	k_spinlock_key_t key;

	if (trace == NULL) {
		return;
	}
	key = k_spin_lock(&trace->lock);
	saturating_increment(&trace->pre_acquisition_callbacks,
				     &trace->counters_saturated);
	k_spin_unlock(&trace->lock, key);
}

void node_a_acquisition_trace_note_timestamp_result(
	struct node_a_acquisition_trace *trace, bool available)
{
	k_spinlock_key_t key;

	if (trace == NULL) {
		return;
	}
	key = k_spin_lock(&trace->lock);
	if (available) {
		saturating_increment(&trace->timestamp_available,
				     &trace->counters_saturated);
	} else {
		saturating_increment(&trace->timestamp_missing,
				     &trace->counters_saturated);
	}
	k_spin_unlock(&trace->lock, key);
}

void node_a_acquisition_trace_note_raw_read_result(
	struct node_a_acquisition_trace *trace, int rc)
{
	k_spinlock_key_t key;

	if (trace == NULL) {
		return;
	}
	key = k_spin_lock(&trace->lock);
	saturating_increment(&trace->raw_read_attempts,
				     &trace->counters_saturated);
	if (rc < 0) {
		saturating_increment(&trace->raw_read_failures,
				     &trace->counters_saturated);
	} else {
		saturating_increment(&trace->raw_read_successes,
				     &trace->counters_saturated);
	}
	trace->last_raw_read_rc = (int32_t)rc;
	k_spin_unlock(&trace->lock, key);
}

void node_a_acquisition_trace_note_notify_duration(
	struct node_a_acquisition_trace *trace, uint32_t duration_us)
{
	k_spinlock_key_t key;

	if (trace == NULL) {
		return;
	}
	key = k_spin_lock(&trace->lock);
	saturating_increment(&trace->notify_calls,
				     &trace->counters_saturated);
	if (duration_us > trace->notify_max_duration) {
		trace->notify_max_duration = duration_us;
	}
	k_spin_unlock(&trace->lock, key);
}

void node_a_acquisition_trace_snapshot_get(
	struct node_a_acquisition_trace *trace,
	struct node_a_acquisition_trace_snapshot *snapshot)
{
	k_spinlock_key_t key;

	if ((trace == NULL) || (snapshot == NULL)) {
		return;
	}
	key = k_spin_lock(&trace->lock);
	*snapshot = (struct node_a_acquisition_trace_snapshot){
		.callback_entries = trace->callback_entries,
		.pre_acquisition_callbacks = trace->pre_acquisition_callbacks,
		.timestamp_available = trace->timestamp_available,
		.timestamp_missing = trace->timestamp_missing,
		.raw_read_attempts = trace->raw_read_attempts,
		.raw_read_successes = trace->raw_read_successes,
		.raw_read_failures = trace->raw_read_failures,
		.notify_calls = trace->notify_calls,
		.notify_max_duration = trace->notify_max_duration,
		.last_raw_read_rc = trace->last_raw_read_rc,
		.counters_saturated = trace->counters_saturated,
	};
	k_spin_unlock(&trace->lock, key);
}
```

## src/acquisition_trace.h
```c
/*
 * Copyright (c) 2026 KineIMU Shoulder contributors
 * SPDX-License-Identifier: Apache-2.0
 */

#ifndef KINEIMU_NODE_A_ACQUISITION_TRACE_H_
#define KINEIMU_NODE_A_ACQUISITION_TRACE_H_

#include <stdbool.h>
#include <stdint.h>

#include <zephyr/spinlock.h>

struct node_a_acquisition_trace {
	struct k_spinlock lock;
	uint32_t callback_entries;
	uint32_t pre_acquisition_callbacks;
	uint32_t timestamp_available;
	uint32_t timestamp_missing;
	uint32_t raw_read_attempts;
	uint32_t raw_read_successes;
	uint32_t raw_read_failures;
	uint32_t notify_calls;
	uint32_t notify_max_duration;
	int32_t last_raw_read_rc;
	bool counters_saturated;
};

struct node_a_acquisition_trace_snapshot {
	uint32_t callback_entries;
	uint32_t pre_acquisition_callbacks;
	uint32_t timestamp_available;
	uint32_t timestamp_missing;
	uint32_t raw_read_attempts;
	uint32_t raw_read_successes;
	uint32_t raw_read_failures;
	uint32_t notify_calls;
	uint32_t notify_max_duration;
	int32_t last_raw_read_rc;
	bool counters_saturated;
};

void node_a_acquisition_trace_init(struct node_a_acquisition_trace *trace);

void node_a_acquisition_trace_note_callback_entry(
	struct node_a_acquisition_trace *trace);

void node_a_acquisition_trace_note_pre_acquisition(
	struct node_a_acquisition_trace *trace);

void node_a_acquisition_trace_note_timestamp_result(
	struct node_a_acquisition_trace *trace, bool available);

void node_a_acquisition_trace_note_raw_read_result(
	struct node_a_acquisition_trace *trace, int rc);

void node_a_acquisition_trace_note_notify_duration(
	struct node_a_acquisition_trace *trace, uint32_t duration_us);

void node_a_acquisition_trace_snapshot_get(
	struct node_a_acquisition_trace *trace,
	struct node_a_acquisition_trace_snapshot *snapshot);

#endif /* KINEIMU_NODE_A_ACQUISITION_TRACE_H_ */
```

## src/counters.c
```c
/*
 * Copyright (c) 2026 KineIMU Shoulder contributors
 * SPDX-License-Identifier: Apache-2.0
 */

#include "counters.h"

void node_a_counters_start(struct node_a_stream_counters *counters,
			   uint32_t clock_epoch)
{
	counters->clock_epoch = clock_epoch;
	counters->sample_counter = 0U;
	counters->packet_counter = 0U;
}

uint32_t node_a_counters_take_sample(struct node_a_stream_counters *counters)
{
	return counters->sample_counter++;
}

uint32_t node_a_counters_take_packet(struct node_a_stream_counters *counters)
{
	return counters->packet_counter++;
}

void node_a_counters_reset_clock(struct node_a_stream_counters *counters)
{
	node_a_counters_start(counters, counters->clock_epoch + 1U);
}
```

## src/counters.h
```c
/*
 * Copyright (c) 2026 KineIMU Shoulder contributors
 * SPDX-License-Identifier: Apache-2.0
 */

#ifndef KINEIMU_NODE_A_COUNTERS_H_
#define KINEIMU_NODE_A_COUNTERS_H_

#include <stdint.h>

/* One writer owns each next-sequence field. Clock resets occur only while
 * acquisition and packet generation are stopped.
 */
struct node_a_stream_counters {
	uint32_t clock_epoch;
	uint32_t sample_counter;
	uint32_t packet_counter;
};

void node_a_counters_start(struct node_a_stream_counters *counters,
			   uint32_t clock_epoch);

uint32_t node_a_counters_take_sample(struct node_a_stream_counters *counters);

uint32_t node_a_counters_take_packet(struct node_a_stream_counters *counters);

void node_a_counters_reset_clock(struct node_a_stream_counters *counters);

#endif /* KINEIMU_NODE_A_COUNTERS_H_ */
```

## src/identity.c
```c
/*
 * Copyright (c) 2026 KineIMU Shoulder contributors
 * SPDX-License-Identifier: Apache-2.0
 */

#include "identity.h"

uint64_t node_a_ficr_device_id_from_words(uint32_t deviceid0,
						  uint32_t deviceid1)
{
	return ((uint64_t)deviceid1 << 32) | (uint64_t)deviceid0;
}
```

## src/identity.h
```c
/*
 * Copyright (c) 2026 KineIMU Shoulder contributors
 * SPDX-License-Identifier: Apache-2.0
 */

#ifndef KINEIMU_NODE_IDENTITY_H_
#define KINEIMU_NODE_IDENTITY_H_

#include <stdint.h>

/* M1 identity/config encodes (DEVICEID[1] << 32) | DEVICEID[0]. */
uint64_t node_a_ficr_device_id_from_words(uint32_t deviceid0,
						  uint32_t deviceid1);

#endif /* KINEIMU_NODE_IDENTITY_H_ */
```

## src/lsm6dsl_fifo.c
```c
/*
 * Copyright (c) 2026 KineIMU Shoulder contributors
 * SPDX-License-Identifier: Apache-2.0
 */

#include <errno.h>
#include <string.h>

#include <zephyr/sys/util.h>

#include "lsm6dsl_fifo.h"
#include "packet.h"

#define LSM6DSL_FIFO_STATUS_BYTES 2U
#define LSM6DSL_FIFO_STATUS2_WATERMARK BIT(7)
#define LSM6DSL_FIFO_STATUS2_OVERRUN BIT(6)
#define LSM6DSL_FIFO_STATUS2_FULL BIT(5)
#define LSM6DSL_FIFO_STATUS2_EMPTY BIT(4)
#define LSM6DSL_FIFO_STATUS2_DIFF_HIGH_MASK 0x07U

static void saturating_increment(uint32_t *counter, bool *saturated)
{
	if (*counter < UINT32_MAX) {
		(*counter)++;
	}
	if (*counter == UINT32_MAX) {
		*saturated = true;
	}
}

int node_a_lsm6dsl_read_fifo_status(
	const struct i2c_dt_spec *spec,
	node_a_lsm6dsl_burst_read_fn burst_read,
	struct node_a_lsm6dsl_fifo_status *status)
{
	uint8_t registers[LSM6DSL_FIFO_STATUS_BYTES];
	struct node_a_lsm6dsl_fifo_status decoded;
	int rc;

	if ((spec == NULL) || (burst_read == NULL) || (status == NULL)) {
		return -EINVAL;
	}

	/* Zephyr's st,lsm6dsl sensor API does not expose FIFO status. Keep this
	 * direct register read in the LSM6DS3TR-C adapter so no backend convention
	 * leaks into the acquisition record or silently changes the raw boundary.
	 */
	rc = burst_read(spec, NODE_A_LSM6DSL_FIFO_STATUS_START, registers,
			LSM6DSL_FIFO_STATUS_BYTES);
	if (rc < 0) {
		return rc;
	}

	decoded.status1_raw = registers[0];
	decoded.status2_raw = registers[1];
	decoded.unread_words = (uint16_t)registers[0] |
		((uint16_t)(registers[1] & LSM6DSL_FIFO_STATUS2_DIFF_HIGH_MASK)
		 << 8);
	decoded.watermark = (registers[1] & LSM6DSL_FIFO_STATUS2_WATERMARK) != 0U;
	decoded.overrun = (registers[1] & LSM6DSL_FIFO_STATUS2_OVERRUN) != 0U;
	decoded.full = (registers[1] & LSM6DSL_FIFO_STATUS2_FULL) != 0U;
	decoded.empty = (registers[1] & LSM6DSL_FIFO_STATUS2_EMPTY) != 0U;

	/* Commit only after the complete two-register snapshot decoded. */
	*status = decoded;
	return 0;
}

void node_a_lsm6dsl_fifo_observer_init(
	struct node_a_lsm6dsl_fifo_observer *observer)
{
	if (observer != NULL) {
		memset(observer, 0, sizeof(*observer));
	}
}

void node_a_lsm6dsl_fifo_observe(
	struct node_a_lsm6dsl_fifo_observer *observer,
	const struct node_a_lsm6dsl_fifo_status *status)
{
	k_spinlock_key_t key;

	if ((observer == NULL) || (status == NULL)) {
		return;
	}
	key = k_spin_lock(&observer->lock);

	/* OVER_RUN is a status level, not a per-read event. Count only a new
	 * assertion; a later clear followed by an assertion is a new event.
	 */
	if (status->overrun && !observer->overrun_asserted) {
		saturating_increment(&observer->sensor_fifo_overruns,
				     &observer->counters_saturated);
		observer->pending_packet_flags |=
			NODE_A_PACKET_FLAG_SENSOR_FIFO_OVERRUN;
	}
	observer->overrun_asserted = status->overrun;
	k_spin_unlock(&observer->lock, key);
}

uint16_t node_a_lsm6dsl_fifo_take_packet_flags(
	struct node_a_lsm6dsl_fifo_observer *observer)
{
	k_spinlock_key_t key;
	uint16_t flags;

	if (observer == NULL) {
		return 0U;
	}

	key = k_spin_lock(&observer->lock);
	flags = observer->pending_packet_flags;
	observer->pending_packet_flags = 0U;
	k_spin_unlock(&observer->lock, key);
	return flags;
}

void node_a_lsm6dsl_fifo_stats_get(
	struct node_a_lsm6dsl_fifo_observer *observer,
	struct node_a_lsm6dsl_fifo_stats *stats)
{
	k_spinlock_key_t key;

	if ((observer == NULL) || (stats == NULL)) {
		return;
	}

	key = k_spin_lock(&observer->lock);
	stats->sensor_fifo_overruns = observer->sensor_fifo_overruns;
	stats->counters_saturated = observer->counters_saturated;
	k_spin_unlock(&observer->lock, key);
}
```

## src/lsm6dsl_fifo.h
```c
/*
 * Copyright (c) 2026 KineIMU Shoulder contributors
 * SPDX-License-Identifier: Apache-2.0
 */

#ifndef KINEIMU_NODE_A_LSM6DSL_FIFO_H_
#define KINEIMU_NODE_A_LSM6DSL_FIFO_H_

#include <stdbool.h>
#include <stdint.h>

#include "lsm6dsl_raw.h"

#include <zephyr/spinlock.h>

#define NODE_A_LSM6DSL_FIFO_STATUS_START 0x3aU

struct node_a_lsm6dsl_fifo_status {
	uint8_t status1_raw;
	uint8_t status2_raw;
	uint16_t unread_words;
	bool watermark;
	bool overrun;
	bool full;
	bool empty;
};

struct node_a_lsm6dsl_fifo_observer {
	struct k_spinlock lock;
	uint32_t sensor_fifo_overruns;
	bool overrun_asserted;
	bool counters_saturated;
	uint16_t pending_packet_flags;
};

struct node_a_lsm6dsl_fifo_stats {
	uint32_t sensor_fifo_overruns;
	bool counters_saturated;
};

int node_a_lsm6dsl_read_fifo_status(
	const struct i2c_dt_spec *spec,
	node_a_lsm6dsl_burst_read_fn burst_read,
	struct node_a_lsm6dsl_fifo_status *status);

void node_a_lsm6dsl_fifo_observer_init(
	struct node_a_lsm6dsl_fifo_observer *observer);

void node_a_lsm6dsl_fifo_observe(
	struct node_a_lsm6dsl_fifo_observer *observer,
	const struct node_a_lsm6dsl_fifo_status *status);

uint16_t node_a_lsm6dsl_fifo_take_packet_flags(
	struct node_a_lsm6dsl_fifo_observer *observer);

void node_a_lsm6dsl_fifo_stats_get(
	struct node_a_lsm6dsl_fifo_observer *observer,
	struct node_a_lsm6dsl_fifo_stats *stats);

#endif /* KINEIMU_NODE_A_LSM6DSL_FIFO_H_ */
```

## src/lsm6dsl_raw.c
```c
/*
 * Copyright (c) 2026 KineIMU Shoulder contributors
 * SPDX-License-Identifier: Apache-2.0
 */

#include <errno.h>
#include <stddef.h>
#include <string.h>

#include "lsm6dsl_raw.h"
#include "node_config.h"
#include "packet.h"

#define LSM6DSL_OUTX_L_G 0x22U
#define LSM6DSL_RAW_BURST_BYTES 12U
#define LSM6DSL_AXIS_BYTES 2U
#define LSM6DSL_AXIS_COUNT 3U
#define LSM6DSL_ACCEL_OFFSET 6U

/*
 * Raw-code clipping criterion for the configured M1 ranges.
 *
 * The LSM6DS3TR-C datasheet specifies two's-complement 16-bit output and
 * nominal sensitivities of 0.122 mg/LSB at +/-4 g and 17.50 mdps/LSB at
 * +/-500 dps. The first integer code at or above a configured full scale is
 * ceil(full_scale / sensitivity), evaluated below with integer sub-units:
 *
 *   accel: ceil(4,000 mg * 1,000 / 122 micro-mg/LSB) = 32,787 codes
 *   gyro:  ceil(500,000 mdps * 100 / 1,750 centi-mdps/LSB) = 28,572 codes
 *
 * The acceleration code is beyond the signed int16 representation. Its
 * auditable raw-code criterion is therefore exactly the two representable
 * int16 endpoints (+32767 and -32768). The gyro criterion is +/-28,572.
 * There is no extra near-full-scale margin in either criterion. These flags
 * report a code at or beyond the configured full-scale-equivalent boundary;
 * they do not prove that the analog sensing element itself saturated.
 */
#define NODE_A_ACCEL_FULL_SCALE_MG NODE_A_ACCEL_RANGE_MG
#define NODE_A_ACCEL_SENSITIVITY_UMG_PER_LSB 122U
#define NODE_A_ACCEL_FS_CODE_CEIL \
	((NODE_A_ACCEL_FULL_SCALE_MG * 1000U + \
	  NODE_A_ACCEL_SENSITIVITY_UMG_PER_LSB - 1U) / \
	 NODE_A_ACCEL_SENSITIVITY_UMG_PER_LSB)
#define NODE_A_GYRO_FULL_SCALE_MDPS NODE_A_GYRO_RANGE_MDPS
#define NODE_A_GYRO_SENSITIVITY_CENTI_MDPS_PER_LSB 1750U
#define NODE_A_GYRO_FS_CODE_CEIL \
	((NODE_A_GYRO_FULL_SCALE_MDPS * 100U + \
	  NODE_A_GYRO_SENSITIVITY_CENTI_MDPS_PER_LSB - 1U) / \
	 NODE_A_GYRO_SENSITIVITY_CENTI_MDPS_PER_LSB)

#define NODE_A_CLIP_POSITIVE_LIMIT(fs_code) \
	(((fs_code) < (uint32_t)INT16_MAX) ? \
	 (uint32_t)(fs_code) : (uint32_t)INT16_MAX)
#define NODE_A_CLIP_NEGATIVE_MAGNITUDE(fs_code) \
	(((fs_code) < ((uint32_t)INT16_MAX + 1U)) ? \
	 (uint32_t)(fs_code) : ((uint32_t)INT16_MAX + 1U))

static bool raw_count_reaches_limit(int16_t count,
				     uint32_t positive_limit,
				     uint32_t negative_magnitude)
{
	const int32_t signed_count = (int32_t)count;

	return (signed_count >= (int32_t)positive_limit) ||
		(signed_count <= -(int32_t)negative_magnitude);
}

static uint16_t detect_clipping_flags(const int16_t accel_raw[3],
				      const int16_t gyro_raw[3],
				      uint16_t existing_flags)
{
	uint16_t flags = existing_flags & (uint16_t)~(
		NODE_A_SAMPLE_FLAG_ACCEL_CLIPPED |
		NODE_A_SAMPLE_FLAG_GYRO_CLIPPED);
	const uint32_t accel_positive_limit =
		NODE_A_CLIP_POSITIVE_LIMIT(NODE_A_ACCEL_FS_CODE_CEIL);
	const uint32_t accel_negative_magnitude =
		NODE_A_CLIP_NEGATIVE_MAGNITUDE(NODE_A_ACCEL_FS_CODE_CEIL);
	const uint32_t gyro_limit =
		NODE_A_CLIP_POSITIVE_LIMIT(NODE_A_GYRO_FS_CODE_CEIL);

	for (size_t axis = 0U; axis < LSM6DSL_AXIS_COUNT; ++axis) {
		if (raw_count_reaches_limit(accel_raw[axis],
						    accel_positive_limit,
						    accel_negative_magnitude)) {
			flags |= NODE_A_SAMPLE_FLAG_ACCEL_CLIPPED;
		}
		if (raw_count_reaches_limit(gyro_raw[axis], gyro_limit,
						    gyro_limit)) {
			flags |= NODE_A_SAMPLE_FLAG_GYRO_CLIPPED;
		}
	}

	return flags;
}

static int16_t decode_le_i16(const uint8_t *bytes)
{
	return (int16_t)((uint16_t)bytes[0] |
			 ((uint16_t)bytes[1] << 8));
}

int node_a_lsm6dsl_read_raw(
	const struct i2c_dt_spec *spec,
	node_a_lsm6dsl_burst_read_fn burst_read,
	struct node_a_imu_sample *sample)
{
	uint8_t registers[LSM6DSL_RAW_BURST_BYTES];
	int16_t accel_raw[LSM6DSL_AXIS_COUNT];
	int16_t gyro_raw[LSM6DSL_AXIS_COUNT];
	int rc;

	if ((spec == NULL) || (burst_read == NULL) || (sample == NULL)) {
		return -EINVAL;
	}

	rc = burst_read(spec, LSM6DSL_OUTX_L_G, registers,
			LSM6DSL_RAW_BURST_BYTES);
	if (rc < 0) {
		return rc;
	}

	for (size_t axis = 0U; axis < LSM6DSL_AXIS_COUNT; ++axis) {
		gyro_raw[axis] =
			decode_le_i16(&registers[axis * LSM6DSL_AXIS_BYTES]);
		accel_raw[axis] = decode_le_i16(
			&registers[LSM6DSL_ACCEL_OFFSET +
				   axis * LSM6DSL_AXIS_BYTES]);
	}

	memcpy(sample->accel_raw, accel_raw, sizeof(accel_raw));
	memcpy(sample->gyro_raw, gyro_raw, sizeof(gyro_raw));
	sample->flags = detect_clipping_flags(
		accel_raw, gyro_raw, sample->flags);
	return 0;
}
```

## src/lsm6dsl_raw.h
```c
/*
 * Copyright (c) 2026 KineIMU Shoulder contributors
 * SPDX-License-Identifier: Apache-2.0
 */

#ifndef KINEIMU_NODE_A_LSM6DSL_RAW_H_
#define KINEIMU_NODE_A_LSM6DSL_RAW_H_

#include <stdint.h>

#include <zephyr/drivers/i2c.h>

#include "acquisition.h"

typedef int (*node_a_lsm6dsl_burst_read_fn)(
	const struct i2c_dt_spec *spec, uint8_t start_addr, uint8_t *buf,
	uint32_t num_bytes);

int node_a_lsm6dsl_read_raw(
	const struct i2c_dt_spec *spec,
	node_a_lsm6dsl_burst_read_fn burst_read,
	struct node_a_imu_sample *sample);

#endif /* KINEIMU_NODE_A_LSM6DSL_RAW_H_ */
```
